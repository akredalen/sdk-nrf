## CMakeLists.txt
```
#
# Copyright (c) 2021 Nordic Semiconductor ASA
#
# SPDX-License-Identifier: LicenseRef-BSD-5-Clause-Nordic
#
cmake_minimum_required(VERSION 3.13.1)

find_package(Zephyr REQUIRED HINTS $ENV{ZEPHYR_BASE})
project(NONE)

target_sources(app PRIVATE
	src/main.c
	src/model_handler.c
	src/settings_srv.c)
target_include_directories(app PRIVATE include)

zephyr_library_include_directories(
	${CMAKE_CURRENT_SOURCE_DIR}
	${NRF_DIR}/subsys/bluetooth/mesh)
```

## prj.conf
```kconfig
#
# Copyright (c) 2019 Nordic Semiconductor ASA
#
# SPDX-License-Identifier: LicenseRef-BSD-5-Clause-Nordic
#
# CONFIG_NCS_SAMPLES_DEFAULTS=y

# # Enable Zephyr application to be booted by MCUboot
# CONFIG_BOOTLOADER_MCUBOOT=y

# General configuration
CONFIG_RESET_ON_FATAL_ERROR=n
CONFIG_SYSTEM_WORKQUEUE_STACK_SIZE=2048
CONFIG_FLASH=y
CONFIG_FLASH_MAP=y
CONFIG_NVS=y
CONFIG_SETTINGS=y
CONFIG_HWINFO=y
CONFIG_LOG=y
CONFIG_LOG_PRINTK=y

CONFIG_DK_LIBRARY=y
CONFIG_BT_MESH_DK_PROV=y

# Bluetooth configuration
CONFIG_BT=y
CONFIG_BT_COMPANY_ID=0x0059
CONFIG_BT_DEVICE_NAME="Mesh Settings Server"
CONFIG_BT_L2CAP_RX_MTU=69
CONFIG_BT_L2CAP_TX_MTU=69
CONFIG_BT_L2CAP_TX_BUF_COUNT=8
CONFIG_BT_LL_SW_SPLIT=y
CONFIG_BT_OBSERVER=y
CONFIG_BT_PERIPHERAL=y
CONFIG_BT_SETTINGS=y
CONFIG_BT_TINYCRYPT_ECC=y

# Disable unused Bluetooth features
CONFIG_BT_CTLR_DUP_FILTER_LEN=0
CONFIG_BT_CTLR_LE_ENC=n
CONFIG_BT_DATA_LEN_UPDATE=n
CONFIG_BT_PHY_UPDATE=n
CONFIG_BT_CTLR_CHAN_SEL_2=n
CONFIG_BT_CTLR_MIN_USED_CHAN=n
CONFIG_BT_CTLR_PRIVACY=n

# Bluetooth Mesh configuration
CONFIG_BT_MESH=y
CONFIG_BT_MESH_RELAY=y
CONFIG_BT_MESH_FRIEND=y
CONFIG_BT_MESH_ADV_BUF_COUNT=13
CONFIG_BT_MESH_TX_SEG_MAX=10
CONFIG_BT_MESH_PB_GATT=y
CONFIG_BT_MESH_GATT_PROXY=y

# HCI_PWR_CTRL #
CONFIG_MAIN_STACK_SIZE=1024
CONFIG_BT_CTLR_ADVANCED_FEATURES=y
CONFIG_BT_CTLR_CONN_RSSI=y
CONFIG_BT_CTLR_TX_PWR_DYNAMIC_CONTROL=y

# # WIZnet W5500 SPI
# CONFIG_SPI=y
# CONFIG_SPI_0=y

# # DFU
# CONFIG_IMG_MANAGER=y
# CONFIG_IMG_ERASE_PROGRESSIVELY=y
# CONFIG_DFU_TARGET=y

# Debugging
CONFIG_DEBUG=y
CONFIG_LOG_BUFFER_SIZE=16000
CONFIG_SEGGER_RTT_BUFFER_SIZE_UP=4096

CONFIG_NCS_SAMPLES_DEFAULTS=n
CONFIG_BT_DEBUG_LOG=y
CONFIG_BT_MESH_DEBUG=y
```

## src/main.c
```c
/*
 * Copyright (c) 2021 Nordic Semiconductor ASA
 *
 * SPDX-License-Identifier: LicenseRef-BSD-5-Clause-Nordic
 */

#include <bluetooth/bluetooth.h>
#include <bluetooth/mesh/models.h>
#include <bluetooth/mesh/dk_prov.h>
#include <dk_buttons_and_leds.h>

#include <zephyr/types.h>
#include <stddef.h>
#include <sys/printk.h>
#include <sys/util.h>
#include <sys/byteorder.h>
#include <zephyr.h>

#include "hp_led.h"
#include "model_handler.h"

#include <logging/log.h>
LOG_MODULE_REGISTER(test, CONFIG_LOG_DEFAULT_LEVEL);

/////////////////////////////// MESH INIT ///////////////////////////////

static struct bt_conn *default_conn;

static void bt_ready(int err)
{
	if (err) {
		printk("Bluetooth init failed (err %d)\n", err);
		return;
	}

	printk("Bluetooth initialized\n");

	dk_leds_init();
	dk_buttons_init(NULL);

	err = bt_mesh_init(bt_mesh_dk_prov_init(), model_handler_init());
	
	if (err) {
		printk("Initializing mesh failed (err %d)\n", err);
		return;
	}

	if (IS_ENABLED(CONFIG_SETTINGS)) {
		settings_load();
	}

	/* This will be a no-op if settings_load() loaded provisioning info */
	bt_mesh_prov_enable(BT_MESH_PROV_ADV | BT_MESH_PROV_GATT);

	printk(" - Mesh initialized -\n");
}

void main(void)
{
	int err;
	default_conn = NULL;

	printk("Initializing...\n");

	err = bt_enable(bt_ready);
	if (err) {
		printk("Bluetooth init failed (err %d)\n", err);
	}
}
```

## include/latency_test.h
```c
/*
 * Copyright (c) 2021 Nordic Semiconductor ASA
 *
 * SPDX-License-Identifier: LicenseRef-BSD-5-Clause-Nordic
 */

#ifndef LATENCY_TEST
#define LATENCY_TEST

#include <stdio.h>
#include <stdint.h>
#include <stdbool.h>
#include <stdlib.h>
#include <string.h>

#define MSG_AMOUNT 50
#define NODES_TOTAL 2

// #define BT_MESH_LATENCY_TEST_OP \
// 		BT_MESH_MODEL_OP_3(0xC4, BT_MESH_NORDIC_SEMI_COMPANY_ID)

// #define BT_MESH_LATENCY_RSP_OP \
// 		BT_MESH_MODEL_OP_3(0xC5, BT_MESH_NORDIC_SEMI_COMPANY_ID)

// #define BT_MESH_TEST_CONFIG_CONFIG_OP \
// 		BT_MESH_MODEL_OP_3(0xC6, BT_MESH_NORDIC_SEMI_COMPANY_ID)

// #define BT_MESH_LATENCY_MSG_LEN_TEST 1
// #define BT_MESH_LATENCY_MSG_LEN_RSP 1
// #define BT_MESH_TEST_MSG_LEN_CONFIG 2

///////////////////////////////////////////////////////


// static uint8_t transmitt_value = 3;

/* MAC address of client/test node */
static uint8_t mac_addr_test_node[6] = {0xB0, 0xAE, 0xD4, 0xDA, 0x35, 0x43};

static struct Node_data{
    uint8_t mac_address[6];
    uint8_t ttl;
};

/* Hard-coded TTL values for each MAC address */
static struct Node_data node_data_mac_ttl[NODES_TOTAL] = {
    {{0xB0, 0xAE, 0xD4, 0xDA, 0x35, 0x43}, 1},
    {{0xDE, 0xAD, 0xFA, 0xCE, 0x00, 0x00}, 2}
    // .....
    };

/* Role of node in network.
The TESTER node is responsible for sending messages to and receiving from the other FIELD noed in the network. 
The TESTER node calculates RRT and logs the results using ethernet.
Tge FIELD node only responds to incoming messages  */
static enum Role {TESTER_N, FIELD_N};

/* Initializes node: self provisioning and default configuration */
int latency_init_test();

/* Sets the address by combining the MSB and the LSB of the MAC address,
and left-shifting by two bits*/
static int set_unicast_addr(uint16_t *addr);

/* Sets the device key by filling the left-most octets with the node MAC address */
static int set_dev_key(uint8_t *key[]);


#endif /* LATENCY_TEST */
```

## include/model_handler.h
```c
/*
 * Copyright (c) 2021 Nordic Semiconductor ASA
 *
 * SPDX-License-Identifier: LicenseRef-BSD-5-Clause-Nordic
 */

/**
 * @file
 * @brief Model handler
 */

#ifndef MODEL_HANDLER_H__
#define MODEL_HANDLER_H__

#include <bluetooth/mesh.h>

#ifdef __cplusplus
extern "C" {
#endif

const struct bt_mesh_comp *model_handler_init(void);

void hci_set_tx_power(uint8_t handle_type, uint16_t handle, uint8_t txp_lvl);

#ifdef __cplusplus
}
#endif

#endif /* MODEL_HANDLER_H__ */
```

## include/settings.h
```c
/*
 * Copyright (c) 2021 Nordic Semiconductor ASA
 *
 * SPDX-License-Identifier: LicenseRef-BSD-5-Clause-Nordic
 */

/** @file
 *  @defgroup bt_mesh_settings Device Settings Models
 *  @{
 *  @brief API for the Device Settings Model.
 */

#ifndef BT_MESH_SETTINGS_H__
#define BT_MESH_SETTINGS_H__

#include <stdlib.h>
#include <bluetooth/mesh/models.h>
#include <bluetooth/mesh/model_types.h>

#ifdef __cplusplus
extern "C" {
#endif

#define BT_MESH_NORDIC_SEMI_COMPANY_ID 0x0059
#define BT_MESH_MODEL_ID_SETTINGS_CLI 0x0005
#define BT_MESH_MODEL_ID_SETTINGS_SRV 0x0006 

#define BT_MESH_DEVICE_SETTINGS_GET_OP \
		BT_MESH_MODEL_OP_3(0xC1, BT_MESH_NORDIC_SEMI_COMPANY_ID)

#define BT_MESH_DEVICE_SETTINGS_SET_OP \
		BT_MESH_MODEL_OP_3(0xC2, BT_MESH_NORDIC_SEMI_COMPANY_ID)

#define BT_MESH_DEVICE_SETTINGS_STATUS_OP \
		BT_MESH_MODEL_OP_3(0xC3, BT_MESH_NORDIC_SEMI_COMPANY_ID)


#define BT_MESH_DEVICE_SETTINGS_MSG_LEN_GET 0 
#define BT_MESH_DEVICE_SETTINGS_MSG_MINLEN_SET 1
#define BT_MESH_DEVICE_SETTINGS_MSG_MAXLEN_SET 5
#define BT_MESH_DEVICE_SETTINGS_MSG_MINLEN_STATUS 1
#define BT_MESH_DEVICE_SETTINGS_MSG_MAXLEN_STATUS 2

/** Mandatory parameters for the Settings Set message. */
struct bt_mesh_settings_set {
	/** TX Power to set on server */
	int8_t txp_value;
};

/** Parameters for the Settings Status message. */
struct bt_mesh_settings_status {
	/** Success / Failure status of Set message */
	bool status;
	/** The present value of the Settings state. */
	int8_t present_txp;
};

#ifdef __cplusplus
}
#endif

/** @} */

#endif /* BT_MESH_SETTINGS_H__ */
```

## include/settings_srv.h
```c
/*
 * Copyright (c) 2021 Nordic Semiconductor ASA
 *
 * SPDX-License-Identifier: LicenseRef-BSD-5-Clause-Nordic
 */

/** @file
 *  @defgroup bt_mesh_settings_srv Device Settings Server model
 *  @{
 *  @brief API for the Device Settings Server model.
 */

#ifndef BT_MESH_SETTINGS_SRV_H__
#define BT_MESH_SETTINGS_SRV_H__

#include <bluetooth/mesh/model_types.h>
#include <bluetooth/mesh/dk_prov.h>

#include "settings.h"

#ifdef __cplusplus
extern "C" {
#endif

/** @def BT_MESH_SETTINGS_SRV_INIT
 *
 * @brief Init parameters for a bt_mesh_settings_srv instance.
 *
 * @param[in] _handlers State access handlers to use in the model instance.
 */
#define BT_MESH_SETTINGS_SRV_INIT(_handlers)								\
	{																		\
		.handlers = _handlers,												\
		.pub = {															\
			.msg = NET_BUF_SIMPLE(BT_MESH_MODEL_BUF_LEN(					\
				BT_MESH_DEVICE_SETTINGS_STATUS_OP,									\
				BT_MESH_DEVICE_SETTINGS_MSG_MAXLEN_STATUS)),							\
		},																	\
	}

/** @def BT_MESH_MODEL_SETTINGS_SRV
 *
 * @brief Device Settings Server model composition data entry.
 *
 * @param[in] _srv Pointer to a bt_mesh_settings_srv instance.
 */
#define BT_MESH_MODEL_SETTINGS_SRV(_srv)									\
	BT_MESH_MODEL_VND_CB(													\
		BT_MESH_NORDIC_SEMI_COMPANY_ID, BT_MESH_MODEL_ID_SETTINGS_SRV,		\
		_bt_mesh_settings_srv_op, &(_srv)->pub,								\
		BT_MESH_MODEL_USER_DATA(struct bt_mesh_settings_srv, _srv),			\
		&_bt_mesh_settings_srv_cb)

/**
 * Device Settings Server instance. Should primarily be initialized with the
 * BT_MESH_SETTINGS_SRV_INIT macro.
 */
struct bt_mesh_settings_srv {
	/** Transaction ID tracker. */
	struct bt_mesh_tid_ctx prev_transaction;
	/** Handler function structure. */
	const struct bt_mesh_settings_srv_handlers *handlers;
	/** Access model pointer. */
	struct bt_mesh_model *model;
	/** Publish parameters. */
	struct bt_mesh_model_pub pub;
};

/** Device Settings Server state access handlers. */
struct bt_mesh_settings_srv_handlers {
	/** @brief Set the Settings state.
	 *
	 * @note This handler is mandatory.
	 *
	 * @param[in] srv Server instance to set the state of.
	 * @param[in] ctx Message context for the message that triggered the
	 * change, or NULL if the change is not coming from a message.
	 * @param[in] set Parameters of the state change.
	 * @param[out] rsp Response structure to be filled, or NULL if no
	 * response is required.
	 */
	void (*const set)(struct bt_mesh_settings_srv *srv,
			  struct bt_mesh_msg_ctx *ctx,
			  const struct bt_mesh_settings_set *set,
			  struct bt_mesh_settings_status *rsp);

	/** @brief Get the Settings state.
	 *
	 * @note This handler is mandatory.
	 *
	 * @param[in] srv Server instance to get the state of.
	 * @param[in] ctx Message context for the message that triggered the
	 * change, or NULL if the change is not coming from a message.
	 * @param[out] rsp Response structure to be filled.
	 */
	void (*const get)(struct bt_mesh_settings_srv *srv,
			  struct bt_mesh_msg_ctx *ctx,
			  struct bt_mesh_settings_status *rsp);
};

void handle_get(struct bt_mesh_model *model, struct bt_mesh_msg_ctx *ctx,
		       struct net_buf_simple *buf);

void handle_set(struct bt_mesh_model *model, struct bt_mesh_msg_ctx *ctx,
		       struct net_buf_simple *buf);

/** @cond INTERNAL_HIDDEN */
extern const struct bt_mesh_model_op _bt_mesh_settings_srv_op[];
extern const struct bt_mesh_model_cb _bt_mesh_settings_srv_cb;
/** @endcond */

#ifdef __cplusplus
}
#endif

/** @} */

#endif /* BT_MESH_SETTINGS_SRV_H__ */
```

## src/latency_test.c
```c
#include <stdio.h>
#include <stdint.h>
#include <stdbool.h>
#include <string.h>

#include <bluetooth/bluetooth.h>
#include <bluetooth/mesh/models.h>
#include "settings.h"
#include "settings_srv.h"
#include "latency_test.h"
#include "pca20036_ethernet.h" // get_own_ utils
#include "ethernet_utils.h" // _are_equal utils
#include <bluetooth/mesh/cfg_cli.h>
#include "../../../../zephyr/subsys/bluetooth/mesh/prov.h"
#include "../../../../zephyr/include/bluetooth/mesh/cfg_cli.h"

// See example og self provisioning:
// C:\git_repos\ncs\zephyr\samples\bluetooth\mesh_provisioner\src\main.c


uint16_t addr;
static uint8_t own_mac[6];


static int init_node(enum Role role){ 

    
    int err;

    static const uint16_t net_idx;
    static const uint16_t app_idx;
    uint8_t *dev_key[16];

    uint8_t net_key[16] = {0}; 
    uint8_t app_key[16] = {0};

    get_own_mac(&own_mac);

    /* Define a unicast address and device key based on MAC address */
        err = set_unicast_addr(&addr);
        if (err){
            printk("Failed to set unicast address");
        }

        set_dev_key(&dev_key);

    /* Self provision */
        err = bt_mesh_provision(net_key, BT_MESH_NET_PRIMARY, 0, 0, addr, dev_key);

    /* Initial configurations */

        err = bt_mesh_cfg_app_key_add(net_idx, addr, net_idx, app_idx, app_key[16], NULL);
        if (err) {
                    printk("Failed to add application key");
                }

        err = bt_mesh_cfg_mod_app_bind(net_idx, addr, addr, app_idx,
                                BT_MESH_MODEL_ID_SETTINGS_SRV, NULL);
                if (err) {
                    printk("Failed to bind application");
                }

    /* Role specific configurations: */
    switch (role) {
        case TESTER_N:

            /* Set publication address */
            // struct bt_mesh_cfg_mod_pub pub{
            //     .addr = addr;
            //     .pub = 
            // };

            // err = bt_mesh_cfg_mod_pub_set(net_idx, addr, addr, BT_MESH_MODEL_ID_SETTINGS_SRV, pub, );

            break;

        case FIELD_N:

            // DO: specify cfg...

        break;

    return err;


    }

};

/* Initialize node and set up parameters */
int latency_init_test(){

    int err;
    
    static enum Role role;

    get_own_mac(&own_mac);

    if (mac_addresses_are_equal(own_mac, mac_addr_test_node)){
        role = TESTER_N;
    }
    else{
        role = FIELD_N;
    }

    err = init_node(role);

    return err;
}

////////////////////////////////////////////////////////////////////////////
//////////////////////////////// TOOLS /////////////////////////////////////
////////////////////////////////////////////////////////////////////////////

/**
 * Returns true if the specified address is an address of the local element.
 */
static bool address_is_local(struct bt_mesh_model *mod, uint16_t addr)
{
	return bt_mesh_model_elem(mod)->addr == addr;
}

/**
 * Returns true if the provided address is unicast address.
 */
static bool address_is_unicast(uint16_t addr)
{
	return (addr > 0) && (addr <= 0x7FFF);
}

/* Formula: Sets the address by using the 16 first bit of the MAC address,
and left-shifting by two bits. Comments provide an example*/
static int set_unicast_addr(uint16_t *addr){

    /* Showing example for MAC {0xB0, 0xAE, 0xD4, 0xDA, 0x35, 0x43} */

    uint8_t msb = own_mac[4];                   // MSB = 0x35 = 0011 0101
    uint8_t lsb = own_mac[5];                   // LSB = 0x43 = 0100 0011

    uint16_t ph;
    
    ph = ((uint16_t)msb << 8) | lsb;            // addr = 0x3543 = 0011 0101 0100 0011
    ph = ph << 2;                               // addr = 0xD50C = 1101 0101 0000 1100

    while (!address_is_unicast(ph)){            // addr = 0x750C = 0111 0101 0000 1100
        ph = ph - 0x1000;                      
    }

     *addr = ph; 

    return address_is_unicast(ph);              // New 16-bit addr:  0x750C
};

static int set_dev_key(uint8_t *key[]){

    for (int i = 0; i < len(own_mac); i++){

        *key[i] = own_mac[i];
    }

    return 0;
};

static const uint8_t *extract_msg(struct net_buf_simple *buf)
{
	buf->data[buf->len - 1] = '\0';
	return net_buf_simple_pull_mem(buf, buf->len);
}
```

## src/model_handler.c
```c
/*
 * Copyright (c) 2021 Nordic Semiconductor ASA
 *
 * SPDX-License-Identifier: LicenseRef-BSD-5-Clause-Nordic
 */
/**
 * @file
 * @brief Model handler for the TX POWER CONTROL Server.
 *
 * Instantiates a Settings Client model for each button on the devkit, as
 * well as the standard Config and Health Server models. Handles all application
 * behavior related to the models.
 */

#include <zephyr/types.h>
#include <stddef.h>
#include <sys/printk.h>
#include <sys/util.h>
#include <sys/byteorder.h>
#include <stdio.h>
#include <stdint.h>
#include <stdbool.h>
#include <string.h>

#include <bluetooth/bluetooth.h>
#include <bluetooth/hci.h>
#include <bluetooth/hci_vs.h>

#include <bluetooth/conn.h>
#include <bluetooth/uuid.h>
#include <bluetooth/gatt.h>
#include <bluetooth/services/hrs.h>

#include <bluetooth/mesh.h>
#include <bluetooth/mesh/models.h>
#include <bluetooth/mesh/dk_prov.h>
#include <dk_buttons_and_leds.h>

#include "model_handler.h"
#include "settings_srv.h"

#include <logging/log.h>
LOG_MODULE_DECLARE(test);

static const struct bt_mesh_settings_srv_handlers settings_handlers;
static struct bt_mesh_settings_srv settings_srv = BT_MESH_SETTINGS_SRV_INIT(&settings_handlers);

////////////////////////////////////////////////////////////////////////////
///////////////////////// DEVICE SETTINGS FUNCTIONALITY ////////////////////
////////////////////////////////////////////////////////////////////////////

#define DEVICE_NAME CONFIG_BT_DEVICE_NAME
#define DEVICE_NAME_LEN (sizeof(DEVICE_NAME) - 1)

static struct bt_conn *default_conn;

/** TX POWER Functions. Source: zephyr/samples/bluetooth/hci_pwr_ctrl/src/main.c*/
void hci_set_tx_power(uint8_t handle_type, uint16_t handle, uint8_t txp_lvl)
{
	struct bt_hci_cp_vs_write_tx_power_level *cp;
	struct bt_hci_rp_vs_write_tx_power_level *rp;
	struct net_buf *buf, *rsp = NULL;
	int err;

	// Allocate a HCI command buffer
	buf = bt_hci_cmd_create(BT_HCI_OP_VS_WRITE_TX_POWER_LEVEL,
				sizeof(*cp));
	if (!buf) {
		printk("Unable to allocate command buffer\n");
		return;
	}

	cp = net_buf_add(buf, sizeof(*cp));
	cp->handle = sys_cpu_to_le16(handle);
	cp->handle_type = handle_type;
	cp->tx_power_level = txp_lvl;

	//Send a HCI command synchronously
	err = bt_hci_cmd_send_sync(BT_HCI_OP_VS_WRITE_TX_POWER_LEVEL,
				   buf, &rsp);
	if (err) {
		uint8_t reason = rsp ?
			((struct bt_hci_rp_vs_write_tx_power_level *)
			  rsp->data)->status : 0;
		printk("Set Tx power err: %d reason 0x%02x\n", err, reason);
		return;
	}
	rp = (void *)rsp->data;

	net_buf_unref(rsp);
}

static void hci_get_tx_power(uint8_t handle_type, uint16_t handle, uint8_t *txp_lvl)
{
	struct bt_hci_cp_vs_read_tx_power_level *cp;
	struct bt_hci_rp_vs_read_tx_power_level *rp;
	struct net_buf *buf, *rsp = NULL;
	int err;

	*txp_lvl = 0xFF;
	buf = bt_hci_cmd_create(BT_HCI_OP_VS_READ_TX_POWER_LEVEL,
				sizeof(*cp));
	if (!buf) {
		printk("Unable to allocate command buffer\n");
		return;
	}

	cp = net_buf_add(buf, sizeof(*cp));
	cp->handle = sys_cpu_to_le16(handle);
	cp->handle_type = handle_type;

	err = bt_hci_cmd_send_sync(BT_HCI_OP_VS_READ_TX_POWER_LEVEL,
				   buf, &rsp);
	if (err) {
		uint8_t reason = rsp ?
			((struct bt_hci_rp_vs_read_tx_power_level *)
			  rsp->data)->status : 0;
		printk("Read Tx power err: %d reason 0x%02x\n", err, reason);
		return;
	}

	rp = (void *)rsp->data;
	*txp_lvl = rp->tx_power_level;

	net_buf_unref(rsp);
}



static void txp_set(struct bt_mesh_settings_srv *srv, struct bt_mesh_msg_ctx *ctx,
		    const struct bt_mesh_settings_set *set,
		    struct bt_mesh_settings_status *rsp)
{
	int8_t txp_get = 0xFF;
	
	if (!default_conn) {

		printk("\n");
		printk("Getting the TX Power level....\n");
		hci_get_tx_power(BT_HCI_VS_LL_HANDLE_TYPE_ADV,
				     0, &txp_get);
		printk("Current TX Power is %d", txp_get);
		printk(" dB\n\n");

		k_sleep(K_SECONDS(2));

		printk("Setting TX Power level to %d", set->txp_value);
		printk(" dB...\n");
		hci_set_tx_power(BT_HCI_VS_LL_HANDLE_TYPE_ADV,
				     0, set->txp_value);

		k_sleep(K_SECONDS(2));

		hci_get_tx_power(BT_HCI_VS_LL_HANDLE_TYPE_ADV,
				     0, &txp_get);
		printk("New TX Power level is set to %d", txp_get); 
		printk(" dB\n\n");

		if (set->txp_value == txp_get){
			rsp->status = true;
		}
		else{
			rsp->status = false;
		}
		rsp->present_txp = txp_get;
	}
}

static void txp_get(struct bt_mesh_settings_srv *srv, struct bt_mesh_msg_ctx *ctx,
		    struct bt_mesh_settings_status *rsp)
{	
	int8_t txp_get = 0xFF;

	if (!default_conn) {

		printk("\n");
		printk("Getting the TX Power level....\n");
		hci_get_tx_power(BT_HCI_VS_LL_HANDLE_TYPE_ADV,
				     0, &txp_get);
		printk("Current TX Power is %d", txp_get);
		printk(" dB\n\n");
	}
	rsp->present_txp = txp_get;
}


////////////////////////////////////////////////////////////////////////////
///////////////////////// HEALTH SERVER SETUP //////////////////////////////
////////////////////////////////////////////////////////////////////////////

/* Set up a repeating delayed work to blink the DK's LEDs when attention is
 * requested.
 */
static struct k_delayed_work attention_blink_work;

static void attention_blink(struct k_work *work)
{
	static int idx;
	const uint8_t pattern[] = {
		BIT(0) | BIT(1),
		BIT(1) | BIT(2),
		BIT(2) | BIT(3),
		BIT(3) | BIT(0),
	};

	dk_set_leds(pattern[idx++ % ARRAY_SIZE(pattern)]);
	k_delayed_work_submit(&attention_blink_work, K_MSEC(30));
}

static void attention_on(struct bt_mesh_model *mod)
{
	k_delayed_work_submit(&attention_blink_work, K_NO_WAIT);
}

static void attention_off(struct bt_mesh_model *mod)
{
	k_delayed_work_cancel(&attention_blink_work);
	dk_set_leds(DK_NO_LEDS_MSK);
}

static const struct bt_mesh_health_srv_cb health_srv_cb = {
	.attn_on = attention_on,
	.attn_off = attention_off,
};

static struct bt_mesh_health_srv health_srv = {
	.cb = &health_srv_cb,
};

BT_MESH_HEALTH_PUB_DEFINE(health_pub, 0);

////////////////////////////////////////////////////////////////////////////
///////////////////////// MODEL SETUP //////////////////////////////////////
////////////////////////////////////////////////////////////////////////////

static const struct bt_mesh_settings_srv_handlers settings_handlers = {
	.set = txp_set,
	.get = txp_get,
};

static struct bt_mesh_elem elements[] = {
	BT_MESH_ELEM(1,
		    BT_MESH_MODEL_LIST(
				 BT_MESH_MODEL_CFG_SRV,
				 BT_MESH_MODEL_HEALTH_SRV(&health_srv, &health_pub)),
			BT_MESH_MODEL_LIST(BT_MESH_MODEL_SETTINGS_SRV(&settings_srv))),
};

static const struct bt_mesh_comp comp = {
	.cid = BT_MESH_NORDIC_SEMI_COMPANY_ID,
	.elem = elements,
	.elem_count = ARRAY_SIZE(elements),
};

const struct bt_mesh_comp *model_handler_init(void)
{
	k_delayed_work_init(&attention_blink_work, attention_blink);

	return &comp;
}
```

## src/model_test.c
```c
#include <bluetooth/bluetooth.h>
#include <bluetooth/mesh/models.h>
#include <dk_buttons_and_leds.h>
#include "model_handler.h"

///////////////// OP CODES AND LENGHTS /////////////////
#define BT_MESH_ONOFF_OP_GET BT_MESH_MODEL_OP_2(0x82, 0x01)
#define BT_MESH_ONOFF_OP_SET BT_MESH_MODEL_OP_2(0x82, 0x02)
#define BT_MESH_ONOFF_OP_STATUS BT_MESH_MODEL_OP_2(0x82, 0x04)

#define BT_MESH_ONOFF_MSG_LEN_GET 0
#define BT_MESH_ONOFF_MSG_MINLEN_SET 2
#define BT_MESH_ONOFF_MSG_MAXLEN_SET 4
#define BT_MESH_ONOFF_MSG_MINLEN_STATUS 1
#define BT_MESH_ONOFF_MSG_MAXLEN_STATUS 3

/////////////////// DEFINITIONS /////////////////////

struct bt_mesh_onoff_srv {
	/** Transaction ID tracker. */
	struct bt_mesh_tid_ctx prev_transaction;
	/** Handler function structure. */
	const struct bt_mesh_onoff_srv_handlers *handlers;
	/** Access model pointer. */
	struct bt_mesh_model *model;
	/** Publish parameters. */
	struct bt_mesh_model_pub pub;
	/* Publication buffer */
	struct net_buf_simple pub_buf;
	/* Publication data */
	uint8_t pub_data[BT_MESH_MODEL_BUF_LEN(
		BT_MESH_ONOFF_OP_STATUS, BT_MESH_ONOFF_MSG_MAXLEN_STATUS)];
	/* Scene entry */
	struct bt_mesh_scene_entry scene;
};

/** Mandatory parameters for the Generic OnOff Set message. */
struct bt_mesh_onoff_set {
	/** State to set. */
	bool on_off;
	/** Transition parameters. */
	const struct bt_mesh_model_transition *transition;
};


struct bt_mesh_onoff_srv_handlers {
	/** @brief Set the OnOff state.
	 *
	 * @note This handler is mandatory.
	 *
	 * @param[in] srv Server instance to set the state of.
	 * @param[in] ctx Message context for the message that triggered the
	 * change, or NULL if the change is not coming from a message.
	 * @param[in] set Parameters of the state change.
	 * @param[out] rsp Response structure to be filled.
	 */
	void (*const set)(struct bt_mesh_onoff_srv *srv,
			  struct bt_mesh_msg_ctx *ctx,
			  const struct bt_mesh_onoff_set *set,
			  struct bt_mesh_onoff_status *rsp);
};



#define BT_MESH_MODEL_ONOFF_SRV(_srv)                                          \
	BT_MESH_MODEL_CB(BT_MESH_MODEL_ID_GEN_ONOFF_SRV,                       \
			 _bt_mesh_onoff_srv_op, &(_srv)->pub,                  \
			 BT_MESH_MODEL_USER_DATA(struct bt_mesh_onoff_srv,     \
						 _srv),                        \
			 &_bt_mesh_onoff_srv_cb)


const struct bt_mesh_model_op _bt_mesh_onoff_srv_op[] = {
	{ BT_MESH_ONOFF_OP_SET, BT_MESH_ONOFF_MSG_MAXLEN_SET, handle_set}, 
    // sier hvilken "handler" som skal kjøre når den gitte OP koden er mottatt
	BT_MESH_MODEL_OP_END,
};

/////////////////////////////////////////////////////////////////////////////////
/////////////////////////////// FUNCTIONALITY ///////////////////////////////////
/////////////////////////////////////////////////////////////////////////////////

static void handle_set(struct bt_mesh_model *model, struct bt_mesh_msg_ctx *ctx,
		       struct net_buf_simple *buf)
{
	if (buf->len != BT_MESH_ONOFF_MSG_MAXLEN_SET) { // sjekker lengde
		return;
	}

	struct bt_mesh_onoff_srv *srv = model->user_data;
	struct bt_mesh_onoff_status status = { 0 };

	srv->handlers->set(srv, ctx, &status); // kjører: .set ---> led_set()


static void led_set(struct bt_mesh_onoff_srv *srv, struct bt_mesh_msg_ctx *ctx,
		    struct bt_mesh_onoff_status *rsp){

                printk("Hello!");
                dk_set_led(1, true);

                // Do some work ....
            }

static const struct bt_mesh_onoff_srv_handlers onoff_handlers = {
    .set = led_set
};

/******************************************************************/
/************************* SNURRE I GANG MESH *********************/
/******************************************************************/

/* Set up a repeating delayed work to blink the DK's LEDs when attention is
 * requested.
 */
static struct k_delayed_work attention_blink_work;

static void attention_blink(struct k_work *work)
{
	static int idx;
	const uint8_t pattern[] = {
		BIT(0) | BIT(1),
		BIT(1) | BIT(2),
		BIT(2) | BIT(3),
		BIT(3) | BIT(0),
	};
	dk_set_leds(pattern[idx++ % ARRAY_SIZE(pattern)]);
	k_delayed_work_submit(&attention_blink_work, K_MSEC(30));
}

static void attention_on(struct bt_mesh_model *mod)
{
	k_delayed_work_submit(&attention_blink_work, K_NO_WAIT);
}

static void attention_off(struct bt_mesh_model *mod)
{
	k_delayed_work_cancel(&attention_blink_work);
	dk_set_leds(DK_NO_LEDS_MSK);
}

static const struct bt_mesh_health_srv_cb health_srv_cb = {
	.attn_on = attention_on,
	.attn_off = attention_off,
};

static struct bt_mesh_health_srv health_srv = {
	.cb = &health_srv_cb,
};

BT_MESH_HEALTH_PUB_DEFINE(health_pub, 0);

static struct bt_mesh_elem elements[] = {
	BT_MESH_ELEM(
		1, BT_MESH_MODEL_LIST(
			BT_MESH_MODEL_CFG_SRV,
			BT_MESH_MODEL_HEALTH_SRV(&health_srv, &health_pub),
			BT_MESH_MODEL_ONOFF_SRV(&led_ctx[0].srv)), // endre kun denne linjen!!
		BT_MESH_MODEL_NONE),
};

static const struct bt_mesh_comp comp = {
	.cid = CONFIG_BT_COMPANY_ID,
	.elem = elements,
	.elem_count = ARRAY_SIZE(elements),
};

const struct bt_mesh_comp *model_handler_init(void)
{
	k_delayed_work_init(&attention_blink_work, attention_blink);

	for (int i = 0; i < ARRAY_SIZE(led_ctx); ++i) {
		k_delayed_work_init(&led_ctx[i].work, led_work);
	}

	return &comp;
}

//////////////////////////////// MAIN.C FILE /////////////////////////////////////

static void bt_ready(int err)
{
	if (err) {
		printk("Bluetooth init failed (err %d)\n", err);
		return;
	}

	printk("Bluetooth initialized\n");

	dk_leds_init();
	dk_buttons_init(NULL);

	err = bt_mesh_init(bt_mesh_dk_prov_init(), model_handler_init());
	if (err) {
		printk("Initializing mesh failed (err %d)\n", err);
		return;
	}

	if (IS_ENABLED(CONFIG_SETTINGS)) {
		settings_load();
	}

	/* This will be a no-op if settings_load() loaded provisioning info */
	bt_mesh_prov_enable(BT_MESH_PROV_ADV | BT_MESH_PROV_GATT);

	printk("Mesh initialized\n");
}

void main(void)
{
	int err;

	printk("Initializing...\n");

	err = bt_enable(bt_ready);
	if (err) {
		printk("Bluetooth init failed (err %d)\n", err);
	}
}
```

## src/settings_srv.c
```c
#include <string.h>
#include "settings_srv.h"
#include "model_utils.h"
#include <bluetooth/mesh/models.h>

#include <zephyr/types.h>
#include <stddef.h>
#include <sys/printk.h>
#include <sys/util.h>
#include <sys/byteorder.h>

#include "model_utils.h"

static void encode_status(struct net_buf_simple *buf,
			  const struct bt_mesh_settings_status *status)
{
	bt_mesh_model_msg_init(buf, BT_MESH_DEVICE_SETTINGS_STATUS_OP);
	net_buf_simple_add_u8(buf, status->present_txp);
	net_buf_simple_add_u8(buf, status->status);
}

static void rsp_status(struct bt_mesh_model *model,
		       struct bt_mesh_msg_ctx *rx_ctx,
		       const struct bt_mesh_settings_status *status)
{
	BT_MESH_MODEL_BUF_DEFINE(msg, BT_MESH_DEVICE_SETTINGS_STATUS_OP,
				 BT_MESH_DEVICE_SETTINGS_MSG_MAXLEN_STATUS);

	encode_status(&msg, status);

	(void)bt_mesh_model_send(model, rx_ctx, &msg, NULL, NULL);
}

void handle_get(struct bt_mesh_model *model, struct bt_mesh_msg_ctx *ctx,
		       struct net_buf_simple *buf)
{
	if (buf->len != BT_MESH_DEVICE_SETTINGS_MSG_LEN_GET) {
		printk("Error: Buffer length out of scope (1)");
		return;
	}

	printk("SRV: HANDLE GET\n");

	struct bt_mesh_settings_srv *srv = model->user_data;
	struct bt_mesh_settings_status status = { 0 };

	srv->handlers->get(srv, ctx, &status);

	rsp_status(model, ctx, &status);
}

static void settings_set(struct bt_mesh_model *model, struct bt_mesh_msg_ctx *ctx,
		      struct net_buf_simple *buf, bool ack)
{
	if (buf->len < BT_MESH_DEVICE_SETTINGS_MSG_MINLEN_SET ||
	    buf->len > BT_MESH_DEVICE_SETTINGS_MSG_MAXLEN_SET) {
		printk("Error: Buffer length out of scope (settings_set)");
		return;
	}

	struct bt_mesh_settings_srv *srv = model->user_data;
	struct bt_mesh_settings_status status = { 0 };
	struct bt_mesh_settings_set set;

	uint8_t msg = net_buf_simple_pull_u8(buf);
	uint8_t tid = net_buf_simple_pull_u8(buf);

	set.txp_value = msg;

	if (tid_check_and_update(&srv->prev_transaction, tid, ctx) != 0) {
		/* If this is the same transaction, we don't need to send it
		 * to the app, but we still have to respond with a status.
		 */
		srv->handlers->get(srv, NULL, &status);
		goto respond;
	}

	srv->handlers->set(srv, ctx, &set, &status);

	// (void)bt_mesh_settings_srv_pub(srv, NULL, &status);

respond:
	if (ack) {
		rsp_status(model, ctx, &status);
	}
}

/* Gives optional ack */
void handle_set(struct bt_mesh_model *model, struct bt_mesh_msg_ctx *ctx,
		       struct net_buf_simple *buf)
{
	settings_set(model, ctx, buf, true);
}

extern const struct bt_mesh_model_op _bt_mesh_settings_srv_op[];

int32_t bt_mesh_settings_srv_pub(struct bt_mesh_settings_srv *srv,
			    struct bt_mesh_msg_ctx *ctx,
			    const struct bt_mesh_settings_status *status);

int32_t bt_mesh_settings_srv_pub(struct bt_mesh_settings_srv *srv,
			    struct bt_mesh_msg_ctx *ctx,
			    const struct bt_mesh_settings_status *status)
{
	BT_MESH_MODEL_BUF_DEFINE(msg, BT_MESH_DEVICE_SETTINGS_STATUS_OP,
				 BT_MESH_DEVICE_SETTINGS_MSG_MAXLEN_STATUS);
	
	encode_status(&msg, status);
	return model_send(srv->model, ctx, &msg);
}

static int bt_mesh_settings_srv_init(struct bt_mesh_model *model)
{
	struct bt_mesh_settings_srv *srv = model->user_data;

	srv->model = model;
	net_buf_simple_init(model->pub->msg, 0);

	return 0;
}

const struct bt_mesh_model_cb _bt_mesh_settings_srv_cb = {
	.init = bt_mesh_settings_srv_init
};

const struct bt_mesh_model_op _bt_mesh_settings_srv_op[] = {
    { BT_MESH_DEVICE_SETTINGS_GET_OP,    BT_MESH_DEVICE_SETTINGS_MSG_LEN_GET,    handle_get },
    { BT_MESH_DEVICE_SETTINGS_SET_OP,    BT_MESH_DEVICE_SETTINGS_MSG_MINLEN_SET,    handle_set },

    BT_MESH_MODEL_OP_END,
};
```
