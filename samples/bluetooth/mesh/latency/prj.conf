## CMakeLists.txt
```
#
# Copyright (c) 2021 Nordic Semiconductor ASA
#
# SPDX-License-Identifier: LicenseRef-BSD-5-Clause-Nordic
#
cmake_minimum_required(VERSION 3.13.1)

find_package(Zephyr REQUIRED HINTS $ENV{ZEPHYR_BASE})
project(NONE)

target_sources(app PRIVATE
	src/main.c
	src/pca20036_dfu/pca20036_ethernet.c
	src/pca20036_dfu/ethernet_dfu.c
	src/pca20036_dfu/ethernet_command_system.c
	src/pca20036_dfu/ethernet_utils.c
	src/pca20036_dfu/hp_led.c
	../../../../../nrf/samples/bluetooth/mesh/settings_client/src/settings_cli.c
	../../../../../nrf/samples/bluetooth/mesh/settings_server/src/settings_srv.c
	../../../../../modules/hal/wiznet/Callback/dhcp_cb.c
	../../../../../modules/hal/wiznet/Ethernet/W5500/w5500.c
	../../../../../modules/hal/wiznet/Ethernet/socket.c
	../../../../../modules/hal/wiznet/Ethernet/wizchip_conf.c
	../../../../../modules/hal/wiznet/Internet/DHCP/dhcp.c
	../../../../../modules/hal/wiznet/Internet/TFTP/tftp.c
	../../../../../modules/hal/wiznet/Internet/TFTP/netutil.c)
target_include_directories(app PRIVATE include
	../../../../../nrf/samples/bluetooth/mesh/settings_client/src
	../../../../../nrf/samples/bluetooth/mesh/settings_client/include
	../../../../../nrf/samples/bluetooth/mesh/settings_server/src
	../../../../../nrf/samples/bluetooth/mesh/settings_server/include
	../../../../../modules/hal/wiznet/Callback
	../../../../../modules/hal/wiznet/Ethernet
	../../../../../modules/hal/wiznet/Ethernet/W5500
	../../../../../modules/hal/wiznet/Internet/DHCP
	../../../../../modules/hal/wiznet/Internet/TFTP)

zephyr_library_include_directories(
	${CMAKE_CURRENT_SOURCE_DIR}
	${NRF_DIR}/subsys/bluetooth/mesh)
```

## prj.conf
```kconfig
#
# Copyright (c) 2019 Nordic Semiconductor ASA
#
# SPDX-License-Identifier: LicenseRef-BSD-5-Clause-Nordic
#
# CONFIG_NCS_SAMPLES_DEFAULTS=y

# Enable Zephyr application to be booted by MCUboot
CONFIG_BOOTLOADER_MCUBOOT=y

# General configuration
CONFIG_SYSTEM_WORKQUEUE_STACK_SIZE=2048
CONFIG_FLASH=y
CONFIG_FLASH_MAP=y
CONFIG_FCB=y
CONFIG_SETTINGS=y
CONFIG_HWINFO=y

CONFIG_DK_LIBRARY=y
CONFIG_BT_MESH_DK_PROV=y

# Bluetooth configuration
CONFIG_BT=y
CONFIG_BT_COMPANY_ID=0x0059
CONFIG_BT_DEVICE_NAME="Mesh Latency Node"
CONFIG_BT_L2CAP_RX_MTU=69
CONFIG_BT_L2CAP_TX_MTU=69
CONFIG_BT_L2CAP_TX_BUF_COUNT=8
CONFIG_BT_LL_SW_SPLIT=y
CONFIG_BT_OBSERVER=y
CONFIG_BT_PERIPHERAL=y
CONFIG_BT_SETTINGS=y
CONFIG_BT_TINYCRYPT_ECC=y

# Disable unused Bluetooth features
CONFIG_BT_CTLR_DUP_FILTER_LEN=0
CONFIG_BT_CTLR_LE_ENC=n
CONFIG_BT_DATA_LEN_UPDATE=n
CONFIG_BT_PHY_UPDATE=n
CONFIG_BT_CTLR_CHAN_SEL_2=n
CONFIG_BT_CTLR_MIN_USED_CHAN=n
CONFIG_BT_CTLR_PRIVACY=n

# Bluetooth Mesh configuration
CONFIG_BT_MESH=y
CONFIG_BT_MESH_RELAY=y
CONFIG_BT_MESH_FRIEND=y
CONFIG_BT_MESH_ADV_BUF_COUNT=13
CONFIG_BT_MESH_TX_SEG_MAX=10
CONFIG_BT_MESH_PB_GATT=y
CONFIG_BT_MESH_GATT_PROXY=y

CONFIG_BT_MESH_CFG_CLI=y

CONFIG_BT_MESH_PROVISIONER=y
CONFIG_BT_MESH_PROV_DEVICE=y
CONFIG_BT_MESH_BEACON_ENABLED=n

CONFIG_BT_MESH_CDB=y
CONFIG_BT_MESH_CDB_NODE_COUNT=1
CONFIG_BT_MESH_CDB_SUBNET_COUNT=1
CONFIG_BT_MESH_CDB_APP_KEY_COUNT=1

# CONFIG_BT_RX_STACK_SIZE=3000
CONFIG_BT_MESH_TX_SEG_MSG_COUNT=3

# HCI_PWR_CTRL #
CONFIG_MAIN_STACK_SIZE=1000
CONFIG_BT_CTLR_ADVANCED_FEATURES=y
CONFIG_BT_CTLR_CONN_RSSI=y
CONFIG_BT_CTLR_TX_PWR_DYNAMIC_CONTROL=y

# WIZnet W5500 SPI
CONFIG_SPI=y
CONFIG_SPI_0=y

# DFU
CONFIG_IMG_MANAGER=y
CONFIG_IMG_ERASE_PROGRESSIVELY=y
CONFIG_DFU_TARGET=y

# Debugging and logging
CONFIG_LOG_PROCESS_THREAD_SLEEP_MS=250
CONFIG_LOG_STRDUP_MAX_STRING=64
CONFIG_LOG_BLOCK_IN_THREAD=y
CONFIG_LOG_IMMEDIATE=n
CONFIG_LOG_STRDUP_BUF_COUNT=64

CONFIG_LOG=y
CONFIG_LOG_PRINTK=y

CONFIG_DEBUG=y

CONFIG_LOG_BUFFER_SIZE=16000
CONFIG_SEGGER_RTT_BUFFER_SIZE_UP=4096

CONFIG_NCS_SAMPLES_DEFAULTS=n
CONFIG_BT_DEBUG_LOG=y
CONFIG_BT_MESH_DEBUG=y
CONFIG_BT_MESH_DEBUG_ACCESS=n

CONFIG_LOG_DEFAULT_LEVEL=4
#     - 0 OFF, do not write by default
# 	  - 1 ERROR, default to only write LOG_LEVEL_ERR
# 	  - 2 WARNING, default to write LOG_LEVEL_WRN
# 	  - 3 INFO, default to write LOG_LEVEL_INFO
# 	  - 4 DEBUG, default to write LOG_LEVEL_DBG

# Enable Shell module and use UART as a backend
CONFIG_SHELL=y
CONFIG_SHELL_BACKEND_SERIAL=y
```

## src/main.c
```c
/*
 * Copyright (c) 2021 Nordic Semiconductor ASA
 *
 * SPDX-License-Identifier: LicenseRef-BSD-5-Clause-Nordic
 */

#include <bluetooth/bluetooth.h>
#include <bluetooth/mesh/models.h>
#include <bluetooth/mesh/dk_prov.h>
#include <bluetooth/mesh/cfg_cli.h>

#include <zephyr/types.h>
#include <stddef.h>
#include <sys/printk.h>
#include <sys/util.h>
#include <sys/byteorder.h>
#include <zephyr.h>
#include <dk_buttons_and_leds.h>

#include <settings.h>
#include <settings_srv.h>
#include <settings_cli.h>
#include <wizchip_conf.h>
#include <w5500.h>
#include <logging/log.h>
#include <shell/shell.h>
#include <shell/shell_uart.h>
#include <inttypes.h>

// #define BT_DBG_ENABLED IS_ENABLED(CONFIG_BT_MESH_DEBUG_MODEL)
#define LOG_MODULE_NAME latency

static const struct shell *test_shell;

#include "common/log.h"
#include "pca20036_ethernet.h"
#include "ethernet_command_system.h"
#include "ethernet_dfu.h"
#include "hp_led.h"
#include "latency_test.h"
#include "ethernet_utils.h"
#include "settings_cli.h"

/** Self-Provisioning and -configuration; */
static uint16_t own_addr = 0x0000;
static uint8_t own_mac[6];
static enum Role role; 

static const uint16_t net_idx = BT_MESH_NET_PRIMARY;
static const uint16_t app_idx = 0;
static uint8_t dev_key[16];
static const uint8_t net_key[16] ={1,2,3,4,5,6,7,8,9,10,11,12,13,14,15,16}; 
static const uint8_t dev_uuid[16] = { 0xdd, 0xdd };

/** LATENCY TEST;
 * OUTBOUND messages are those that are sent from the TEST node, to the FIELD node.
 * INBOUND messages are those that are sent from the FIELD node, back to the TEST node
 * RTT is the calculated Round-Trip-Time
*/
static int64_t out_time; 
static int64_t in_time;
static int64_t rtt;
static int lost_msg_count = 0;

static uint16_t target_addr = 0x0000;

static uint8_t target_mac[6];
static int target_ttl;

static struct bt_mesh_cfg_mod_pub pub = {
        .addr = 0x0000,
        .app_idx = app_idx,
        .cred_flag = false,
        .ttl = 0,
        .period = 0,
        .transmit = 2, 
    };

////////////////////////////////////////////////////////////////////////
///////////////////////// TEST COMMANDS ////////////////////////////////
////////////////////////////////////////////////////////////////////////

/** COMMANDS;
 * To start latency test, use command: > test latency
*/
 
static int cmd_test(const struct shell *shell, size_t argc, char *argv[])
{
    shell_print(shell, "--- Starting Latency Test ---", argv[1]);
	latency_test_run();
 
    return 0;
}
 
SHELL_STATIC_SUBCMD_SET_CREATE(test_cmds,
    SHELL_CMD_ARG(latency, NULL, "Print Test", cmd_test, 1, 0), // TEST
    SHELL_SUBCMD_SET_END
);
 
SHELL_CMD_ARG_REGISTER(test, &test_cmds, "Bluetooth Mesh Test commands",
               cmd_test, 1, 1);

////////////////////////////////////////////////////////////////////////////
//////////////////////////////// TOOLS /////////////////////////////////////
////////////////////////////////////////////////////////////////////////////

/* Returns true if the provided address is unicast address.*/
static bool address_is_unicast(uint16_t addr)
{
	return (addr > 0) && (addr <= 0x7FFF);
}

/* Sets the address by combining the two rightmost 8-bits of the MAC address,
and left-shifting by two bits*/
static int define_unicast_addr(uint16_t *addr, uint8_t mac[6]){

    /* Showing example for MAC {0xB0, 0xAE, 0xD4, 0xDA, 0x35, 0x43} */

    uint8_t msb = mac[4];                   // MSB = 0x35 = 0011 0101
    uint8_t lsb = mac[5];                   // LSB = 0x43 = 0100 0011

    uint16_t ph;
    
    ph = ((uint16_t)msb << 8) | lsb;            // addr = 0x3543 = 0011 0101 0100 0011
    ph = ph << 2;                               // addr = 0xD50C = 1101 0101 0000 1100
    ph = ph & 0x7FFF;                           // addr = 0x550C = 0101 0101 0000 1100

    *addr = ph; 

    if(address_is_unicast(ph)){
        return 0;
    }
    else{
        return 1;
    }             
}

/* Sets the device key by filling the left-most octets with the node MAC address */
static int define_own_dev_key(){

    uint8_t ph[16] = {0};
    for (int i = 0; i < NELEMS(own_mac); i++){

        ph[i] = own_mac[i];
    }
    
    memcpy(dev_key, ph, 16);

    return 0;
}

static int fetch_own_mac(){
    static wiz_NetInfo gWIZNETINFO;
    int8_t err8;

    err8 = ctlnetwork(CN_GET_NETINFO, (void *)&gWIZNETINFO);
    if (err8 == -1) {
        return 1;
    }

    memcpy(own_mac, gWIZNETINFO.mac, 6);

    return 0;

}

static void setup_cdb(void)
{
	struct bt_mesh_cdb_app_key *key;

	key = bt_mesh_cdb_app_key_alloc(net_idx, app_idx);
	if (key == NULL) {
		BT_WARN("Failed to allocate app-key 0x%04x", app_idx);
		return;
	}

	memset(key->keys[0].app_key, 0xAA, 16);

	if (IS_ENABLED(CONFIG_BT_SETTINGS)) {
		bt_mesh_cdb_app_key_store(key);
	}
}
////////////////////////////////////////////////////////////////////////////
/////////////////////////////// ETHERNET RX WORK ///////////////////////////
////////////////////////////////////////////////////////////////////////////

static struct k_delayed_work ethernet_rx_work;

static void ethernet_rx_work_handler(struct k_work *work)
{
	ethernet_command_system_rx();
	k_delayed_work_submit(&ethernet_rx_work, K_MSEC(10));
}

static void ethernet_rx_work_init_start(void)
{
	k_delayed_work_init(&ethernet_rx_work, ethernet_rx_work_handler);

	k_delayed_work_submit(&ethernet_rx_work, K_NO_WAIT);
}

////////////////////////////////////////////////////////////////////////////
///////////////////////// MODEL SETUP //////////////////////////////////////
////////////////////////////////////////////////////////////////////////////

static struct bt_mesh_health_srv health_srv = {
};

BT_MESH_HEALTH_PUB_DEFINE(health_pub, 0);

static void settings_set(struct bt_mesh_settings_srv *srv,
			  struct bt_mesh_msg_ctx *ctx,
			  const struct bt_mesh_settings_set *set,
			  struct bt_mesh_settings_status *rsp){};

static void settings_get(struct bt_mesh_settings_srv *srv,
			  struct bt_mesh_msg_ctx *ctx,
			  struct bt_mesh_settings_status *rsp){};

static const struct bt_mesh_settings_srv_handlers settings_handlers = {
	.get = settings_get,
	.set = settings_set,
};

static void status_handler(struct bt_mesh_settings_cli *cli,
			   struct bt_mesh_msg_ctx *ctx,
			   const struct bt_mesh_settings_status *status){};

static struct bt_mesh_settings_srv settings_srv = BT_MESH_SETTINGS_SRV_INIT(&settings_handlers);
static struct bt_mesh_settings_cli settings_cli = BT_MESH_SETTINGS_CLI_INIT(&status_handler);

// static struct bt_mesh_cfg_srv cfg_srv = {
// 	.relay = BT_MESH_RELAY_ENABLED,
// 	.beacon = BT_MESH_BEACON_DISABLED,
// 	.frnd = BT_MESH_FRIEND_NOT_SUPPORTED,
// 	.default_ttl = 7,

// 	/* 3 transmissions with 20ms interval */
// 	.net_transmit = BT_MESH_TRANSMIT(2, 20),
// 	.relay_retransmit = BT_MESH_TRANSMIT(3, 20),
// };

static struct bt_mesh_cfg_cli cfg_cli = {};

static struct bt_mesh_elem elements[] = {
	BT_MESH_ELEM(0,
		    BT_MESH_MODEL_LIST(
				 BT_MESH_MODEL_CFG_SRV,
				 BT_MESH_MODEL_CFG_CLI(&cfg_cli),
				 BT_MESH_MODEL_HEALTH_SRV(&health_srv, &health_pub)),
			BT_MESH_MODEL_LIST(
				BT_MESH_MODEL_SETTINGS_CLI(&settings_cli),
				BT_MESH_MODEL_SETTINGS_SRV(&settings_srv))),
};

static const struct bt_mesh_comp comp = {
	.cid = BT_MESH_NORDIC_SEMI_COMPANY_ID,
	.elem = elements,
	.elem_count = ARRAY_SIZE(elements),
};

static const struct bt_mesh_prov prov = {
	.uuid = dev_uuid,
	// .unprovisioned_beacon = unprovisioned_beacon,
	// .node_added = node_added,
};

////////////////////////////////////////////////////////////////////////////
///////////////////////// NODE CONFIGURATION ///////////////////////////////
////////////////////////////////////////////////////////////////////////////

static void configure_self(struct bt_mesh_cdb_node *self){

    struct bt_mesh_cdb_app_key *key;
	int err;

	uint8_t status;

	printk("Configuring self...\n");

	key = bt_mesh_cdb_app_key_get(app_idx);
	if (key == NULL) {
		BT_WARN("No app-key 0x%04x", app_idx);
		return;
	}

	BT_HEXDUMP_DBG(key->keys[0].app_key, 16, "AppKey");

	err = bt_mesh_cfg_app_key_add(net_idx, own_addr, net_idx,
				      app_idx, key->keys[0].app_key, &status);
    if (err < 0) {
            BT_WARN("Failed to add application key: %d, %u", err, status);
            }

    err = bt_mesh_cfg_mod_app_bind_vnd(net_idx, own_addr, own_addr,
				       app_idx, BT_MESH_MODEL_ID_SETTINGS_SRV, BT_MESH_NORDIC_SEMI_COMPANY_ID, &status);
            if (err < 0) {
                BT_WARN("Failed to bind (settings server) to application");
            }

    /* Tester node will also be using the settings client model */
    if (mac_addresses_are_equal(own_mac, mac_addr_test_node)){
		role = TESTER_N;
		BT_DBG("Role: 	TESTER NODE");
		err = bt_mesh_cfg_mod_app_bind_vnd(net_idx, own_addr, own_addr,
				       app_idx, BT_MESH_MODEL_ID_SETTINGS_CLI, BT_MESH_NORDIC_SEMI_COMPANY_ID, &status);
        if (err < 0) {
            BT_WARN("Failed to bind (settings client) application");
        }
	}else{
		role = FIELD_N;
		BT_DBG("Role: 	FIELD NODE");
	}

	atomic_set_bit(self->flags, BT_MESH_CDB_NODE_CONFIGURED);

	if (IS_ENABLED(CONFIG_BT_SETTINGS)) {
		bt_mesh_cdb_node_store(self);
	}

	printk("\n--- Configuration complete ---\n");

}

static uint8_t check_unconfigured(struct bt_mesh_cdb_node *node, void *data)
{
	if (!atomic_test_bit(node->flags, BT_MESH_CDB_NODE_CONFIGURED)) {
		if (node->addr == own_addr) {
			configure_self(node);
		}
	}else{
		BT_DBG("Node is already configured!");
	}

	return BT_MESH_CDB_ITER_CONTINUE;
}

////////////////////////////////////////////////////////////////////////////
/////////////////////////////// MESH INIT //////////////////////////////////
////////////////////////////////////////////////////////////////////////////

static void bt_ready(int err)
{
	if (err) {
		BT_ERR("Bluetooth init failed (err %d)", err);
		return;
	}

	printk("\n--- Bluetooth initialized ---\n");

	err = bt_mesh_init(&prov, &comp);
	if (err) {
		BT_ERR("Initializing mesh failed (err %d)", err);
		return;
	}

	printk("\n--- Mesh initialized ---\n");

	if (IS_ENABLED(CONFIG_SETTINGS)) {
		settings_load();
	}

	/* Create and initialize the Mesh Configuration Database. A primary subnet, 
	ie one with NetIdx 0, will be added and the provided key will be used as
	NetKey for that subnet. */
	err = bt_mesh_cdb_create(net_key);
	if (err == -EALREADY) {
		BT_DBG("Using stored CDB");
	} else if (err) {
		BT_DBG("Failed to create CDB (err %d)", err);
	} else {
		BT_DBG("Created CDB");
		setup_cdb();
	}

	err = fetch_own_mac();
    if (err){
        BT_WARN("Error printing network info");
    }
    else{
        BT_DBG("MAC address: %02X:%02X:%02X:%02X:%02X:%02X", \
        own_mac[0], own_mac[1], own_mac[2], own_mac[3], own_mac[4], own_mac[5]);
    }

    err = define_unicast_addr(&own_addr, own_mac);
    if (err){
        BT_WARN("Failed to set Unicast Address");
    }
    BT_DBG("Unicast address: 0x%04x", own_addr);

    err = define_own_dev_key();
    if (err){
        BT_WARN("Failed to set Device Key");
    }

	if (bt_mesh_is_provisioned()){
        BT_DBG("Node is already provisioned! ");
    }
    else{
        printk("Provisioning device...\n");
        err = bt_mesh_provision(net_key, net_idx, 0, 0, own_addr, dev_key);
        if (err == -EALREADY) {
		    BT_DBG("Using stored settings");
	    } else if (err) {
		    BT_ERR("Provisioning failed (err %d)", err);
	    } else {
		    printk("\n--- Provisioning completed ---\n");
	    }
    }

	// /* This will be a no-op if settings_load() loaded provisioning info */
	// bt_mesh_prov_enable(BT_MESH_PROV_ADV | BT_MESH_PROV_GATT);

	bt_mesh_cdb_node_foreach(check_unconfigured, NULL);

	return;

}

////////////////////////////////////////////////////////////////////////////
///////////////////////// LATENCY TEST /////////////////////////////////////
////////////////////////////////////////////////////////////////////////////

int latency_test_run(){

    if(role == TESTER_N){
		printk("\n");
	}else{
		printk("Can't run latency test from field node!\n");
		return 1;
	}

	int err = 0;
	// uint8_t status;

	for (int i = 0; i < NODES_TOTAL; i++){
	
		lost_msg_count = 0;

		memcpy(target_mac, node_data_mac_ttl[i].mac_address, sizeof(target_mac));
		target_ttl = node_data_mac_ttl[i].ttl;
		define_unicast_addr(&target_addr, target_mac);

		BT_DBG("MAC address (target): %02X:%02X:%02X:%02X:%02X:%02X", \
        target_mac[0], target_mac[1], target_mac[2], target_mac[3], target_mac[4], target_mac[5]);

		 struct bt_mesh_msg_ctx ctx = {
                .addr = target_addr,
				// .addr = own_addr, // # use to test with loopback mode
                .send_ttl = BT_MESH_TTL_DEFAULT,
                .app_idx = 0,
        };
		
		pub.addr = target_addr;
		BT_DBG("Target address: 0x%04x", target_addr);
        pub.ttl = target_ttl; 

		BT_DBG("BEFORE: Settings_cli->pub: 0x%04x", settings_cli.pub.addr);
		BT_DBG("BEFORE: Settings_cli->mod->pub: 0x%04x", settings_cli.model->pub->addr);

        err = bt_mesh_cfg_mod_pub_set_vnd(net_idx, own_addr, own_addr,
         BT_MESH_MODEL_ID_SETTINGS_CLI, BT_MESH_NORDIC_SEMI_COMPANY_ID,
         &pub, NULL);
         
        if (err) {
			BT_WARN("Unable to set publication values");
			return err;
		}

		BT_DBG("AFTER: Settings_cli->pub: 0x%04x", settings_cli.pub.addr);
		BT_DBG("AFTER: Settings_cli->mod->pub: 0x%04x", settings_cli.model->pub->addr);

		/* Send messages to node address */
		for (int j = 0; j < MSG_AMOUNT; j++) {

			struct bt_mesh_settings_status rsp;

			out_time = k_uptime_get();
			// err = bt_mesh_settings_cli_get(&settings_cli, &ctx, &rsp); // # use for ctx
			err = bt_mesh_settings_cli_get(&settings_cli, NULL, &rsp); // # use for pub

			/* Blocking while waiting for response... */
			if (err < 0){
                lost_msg_count++;
				BT_WARN("(erro: %d): Latency message nr. %d failed.\nTotal lost messages: %d", err, j+1, lost_msg_count);
			}
			else{
				/* Response is received. Record new time-stamp */
				in_time = k_uptime_get();
				rtt = in_time - out_time;
				printk("RTT for message nr. %d: %d ms\n", j, (int32_t) rtt);

				// DO: send response over ethernet...
			}
		} 
	} 
	return err;
}


////////////////////////////////////////////////////////////////////////////
///////////////////////// MAIN /////////////////////////////////////////////
////////////////////////////////////////////////////////////////////////////

void main(void)
{
	int err;

	test_shell = shell_backend_uart_get_ptr();
	shell_print(test_shell, ">>> Bluetooth Mesh TEST sample <<<");

	printk("- Latency Test for PCA20036 -\n");
	BT_INFO("- DFU Version: %d -", DFU_APP_VERSION);

	err = hp_led_init();

	if (err) {
		BT_WARN("Error initializing HP LED");
	}

	err = pca20036_ethernet_init();

	if (err) {
		BT_WARN("Error initializing buttons");
	}

	ethernet_rx_work_init_start();

	printk("\n- Ethernet initiated -\n");

	/* DHCP may not be leased yet - check flag */

	printk("Initializing mesh...\n");

	/* Initialize BT Mesh, provision and configure local device */
	err = bt_enable(NULL);
	if (err) {
		BT_ERR("Bluetooth init failed (err %d)", err);
	}

	bt_ready(0);
}
```

## include/ethernet_command_system.h
```c
/*
 * Copyright (c) 2021 Nordic Semiconductor ASA
 *
 * SPDX-License-Identifier: LicenseRef-BSD-5-Clause-Nordic
 */

#ifndef ETHERNET_COMMAND_SYSTEM_H
#define ETHERNET_COMMAND_SYSTEM_H

#include <stdio.h>
#include <stdint.h>
#include <stdbool.h>
#include <string.h>

enum ethernet_ctrl_cmd {
	CMD_RESET = 0x01,
	CMD_I_AM_ALIVE = 0x02,
	CMD_DFU = 0x03,
	CMD_LED = 0x04,

	/* Configuration OP codes */
	CMD_TRANS = 0x05,
	CMD_RELAY = 0x06,

};

struct __attribute((packed)) ethernet_reset_package {
	bool is_broadcast;
	uint8_t target_mac[6];
};

struct __attribute((packed)) ethernet_i_am_alive_package {
	uint8_t ip[4];
	uint8_t mac[6];
	uint8_t version;
};

struct __attribute((packed)) ethernet_dfu_package {
	bool is_broadcast;
	uint8_t target_mac[6];
};

struct __attribute((packed)) ethernet_led_package {
	bool is_broadcast;
	bool on_off;
	uint8_t target_mac[6];
};

struct __attribute((packed)) ethernet_txp_package { // SA
	bool is_broadcast;
	int8_t tx_power;
	uint8_t target_mac[6];
};

struct __attribute((packed)) command_system_package {
	uint32_t identifier;
	uint8_t opcode;
	uint8_t mac[6];
	union {
		struct ethernet_reset_package reset_package;
		struct ethernet_i_am_alive_package i_am_alive_package;
		struct ethernet_dfu_package dfu_package;
		struct ethernet_led_package led_package;
		struct ethernet_txp_package txp_package; // SA
	} payload;
};

void ethernet_command_system_rx(void);

void send_over_ethernet(uint8_t *payload_package, uint8_t opcode);

void ethernet_command_system_init(void);

#endif // ETHERNET_COMMAND_SYSTEM_H
```

## include/ethernet_dfu.h
```c
/*
 * Copyright (c) 2021 Nordic Semiconductor ASA
 *
 * SPDX-License-Identifier: LicenseRef-BSD-5-Clause-Nordic
 */

#ifndef ETHERNET_DFU_H
#define ETHERNET_DFU_H

#include <stdio.h>
#include <stdint.h>
#include <stdbool.h>
#include <stdlib.h>
#include <string.h>

#define DFU_APP_VERSION 2 // Version 2: txp sample

void ethernet_dfu_start(uint8_t *server_ip);

void ethernet_dfu_confirm_image(void);

void ethernet_dfu_init(void);

#endif // ETHERNET_DFU_H
```

## include/latency_test.h
```c
/*
 * Copyright (c) 2021 Nordic Semiconductor ASA
 *
 * SPDX-License-Identifier: LicenseRef-BSD-5-Clause-Nordic
 */

#ifndef LATENCY_TEST
#define LATENCY_TEST

#include <stdio.h>
#include <stdint.h>
#include <stdbool.h>
#include <stdlib.h>
#include <string.h>

#define MSG_AMOUNT 1
#define NODES_TOTAL 1

/* Defines number of elements in array */
#define NELEMS(x)  (sizeof(x) / sizeof((x)[0]))

/* MAC address of client/test node */
static uint8_t mac_addr_test_node[6] = {0xB0, 0x0A, 0x75, 0xA2, 0xDF, 0x53};
// 17 ---> B0:0A:75:A2:DF:53  (TESTER NODE)
// 15 ---> B0:EE:2F:91:30:5A  (1. FIELD NODE)   Unicast address: 16744 / 0x4168
// 2 ---> B0:75:7F:01:64:3B (2. FIELD NODE)
// 12 --->  B0:74:07:DF:98:60 (3. FIELD NODE)
static struct Node_data{
    uint8_t mac_address[6];
    uint8_t ttl;
};

/* Hard-coded TTL values for each MAC address */
static struct Node_data node_data_mac_ttl[NODES_TOTAL] = {
    {{0xB0, 0xEE, 0x2F, 0x91, 0x30, 0x5A}, 0},
    // {{0xB0, 0x0A, 0x75, 0xA2, 0xDF, 0x53}, 2}
    // {{0xB0, 0xAE, 0xD4, 0xDA, 0x35, 0x43}, 1},
    // {{0xDE, 0xAD, 0xFA, 0xCE, 0x00, 0x00}, 2}
    // .....
    };

/* Role of node in network.
The TESTER node is responsible for sending messages to and receiving from the other FIELD noed in the network. 
The TESTER node calculates Round-trip time (rtt) and logs the results using ethernet.
The FIELD node(s) only responds to incoming messages  */
static enum Role {TESTER_N, FIELD_N};

int latency_test_run();

#endif /* LATENCY_TEST */
```

## src/latency_test.c
```c
#include <stdio.h>
#include <stdint.h>
#include <stdbool.h>
#include <string.h>

#include <bluetooth/bluetooth.h>
#include <bluetooth/mesh/models.h>
#include "settings.h"
#include "settings_srv.h"
#include "settings_cli.h"
#include "latency_test.h"
#include "pca20036_ethernet.h" // get_own_ utils
#include "ethernet_utils.h" // _are_equal utils
#include <bluetooth/mesh/cfg_cli.h>
#include "../../../../zephyr/subsys/bluetooth/mesh/prov.h"
#include "../../../../zephyr/include/bluetooth/mesh/cfg_cli.h"
#include "wizchip_conf.h" // modules\hal\wiznet\Ethernet\wizchip_conf.h

// static struct bt_mesh_settings_cli settings_cli = BT_MESH_SETTINGS_CLI_INIT(&status_handler);

/* MAC address of client/test node */
static uint8_t mac_addr_test_node[6] = {0xB0, 0xEE, 0x2F, 0x91, 0x30, 0x5A};
// 15 ---> B0:EE:2F:91:30:5A (TESTER NODE)
// 17 ---> B0:0A:75:A2:DF:53 (FIELD NODE)

static struct Node_data{
    uint8_t mac_address[6];
    uint8_t ttl;
};

/* Hard-coded TTL values for each MAC address */
static struct Node_data node_data_mac_ttl[NODES_TOTAL] = {
    {{0xB0, 0xEE, 0x2F, 0x91, 0x30, 0x5A}, 1},
    {{0xB0, 0x0A, 0x75, 0xA2, 0xDF, 0x53}, 2}
    // {{0xB0, 0xAE, 0xD4, 0xDA, 0x35, 0x43}, 1},
    // {{0xDE, 0xAD, 0xFA, 0xCE, 0x00, 0x00}, 2}
    // .....
    };

/* Role of node in network.
The TESTER node is responsible for sending messages to and receiving from the other FIELD noed in the network. 
The TESTER node calculates Round-trip time (rtt) and logs the results using ethernet.
The FIELD node(s) only responds to incoming messages  */
static enum Role {TESTER_N, FIELD_N};
static enum Role role;

/*
OUTBOUND messages are those that are sent from the TEST node, to the FIELD node.
INBOUND messages are those that are sent from the FIELD node, back to the TEST node
RTT is the calculated Round-Trip-Time
*/
static int64_t out_time; 
static int64_t in_time;
static int64_t rtt;
static int lost_msg_count = 0;


static const uint16_t net_idx = BT_MESH_NET_PRIMARY;
static const uint16_t app_idx = 0;
static uint8_t dev_key[16];
static const uint8_t net_key[16] = {1}; 
static uint8_t app_key[16] = {2};

static uint16_t target_addr = 0x0000;
static uint16_t own_addr = 0x0000;
static uint8_t own_mac[6];
static uint8_t target_mac[6];
static int target_ttl;

////////////////////////////////////////////////////////////////////////////
//////////////////////////////// TOOLS /////////////////////////////////////
////////////////////////////////////////////////////////////////////////////

/**
 * Returns true if the provided address is unicast address.
 */
static bool address_is_unicast(uint16_t addr)
{
	return (addr > 0) && (addr <= 0x7FFF);
}


/* Sets the address by combining the two rightmost 8-bits of the MAC address,
and left-shifting by two bits*/
static int set_unicast_addr(uint16_t *addr, uint8_t own_mac[6]){

    /* Showing example for MAC {0xB0, 0xAE, 0xD4, 0xDA, 0x35, 0x43} */

    uint8_t msb = own_mac[4];                   // MSB = 0x35 = 0011 0101
    uint8_t lsb = own_mac[5];                   // LSB = 0x43 = 0100 0011

    uint16_t ph;
    
    ph = ((uint16_t)msb << 8) | lsb;            // addr = 0x3543 = 0011 0101 0100 0011
    ph = ph << 2;                               // addr = 0xD50C = 1101 0101 0000 1100
    ph = ph & 0x7FFF;                           // addr = 0x550C = 0101 0101 0000 1100

    *addr = ph; 

    if(address_is_unicast(own_addr)){
        return 0;
    }
    else{
        return 1;
    }             
}


/* Sets the device key by filling the left-most octets with the node MAC address */
static int set_dev_key(uint8_t key[16]){

    uint8_t ph[16] = {0};
    for (int i = 0; i < NELEMS(own_mac); i++){

        ph[i] = own_mac[i];
    }
    
    memcpy(dev_key, ph, 16);

    return 0;
}

static int fetch_own_mac(){
    static wiz_NetInfo gWIZNETINFO;
    int8_t err8;
    uint8_t tmp_str[6];

    err8 = ctlnetwork(CN_GET_NETINFO, (void *)&gWIZNETINFO);
    if (err8 == -1) {
        return 1;
    }

    err8 = ctlwizchip(CW_GET_ID, (void *)tmp_str);
    if (err8 == -1) {
        return 1;
    }

    memcpy(own_mac, gWIZNETINFO.mac, 6);

    return 0;

}

////////////////////////////////////////////////////////////////////////////
///////////////////////// LATENCY TEST /////////////////////////////////////
////////////////////////////////////////////////////////////////////////////

int latency_test_run(){

    int err = 0;

	struct bt_mesh_settings_status status;
	struct bt_mesh_msg_ctx ctx;
	
	// err = latency_init_test();
	// if (err){
	// 	printk("Error: Failed to initialize node");
	// 	return err;
	// }

    // set_unicast_addr(&own_addr, mac_addr_test_node);

    static struct bt_mesh_cfg_mod_pub pub = {
        .addr = 0x0000,
        .app_idx = app_idx,
        .cred_flag = false,
        .ttl = 0,
        .period = BT_MESH_PUB_PERIOD_SEC(2),
        .transmit = 3, 
    };

	for (int i = 0; i < NODES_TOTAL; i++){
	
		memcpy(target_mac, node_data_mac_ttl[i].mac_address, sizeof(target_mac));
		target_ttl = node_data_mac_ttl[i].ttl;
		
		set_unicast_addr(&target_addr, target_mac);
		
		ctx.addr = target_addr;

        pub.addr = target_addr;
        pub.ttl = target_ttl;  

        err = bt_mesh_cfg_mod_pub_set_vnd(net_idx, own_addr, 0,
         BT_MESH_MODEL_ID_SETTINGS_CLI, BT_MESH_NORDIC_SEMI_COMPANY_ID,
         &pub, NULL);
         
        if (err) {
			printk("Error: unable to set publication values\n");
			return err;
		}

		/* Send messages to node address */
		for (int j = 0; j < MSG_AMOUNT; j++) {

			out_time = k_uptime_get();
			// err = bt_mesh_settings_cli_get(&settings_cli, &ctx, &status);

			/* Blocking while waiting for a response... */
			if (err < 0){
                lost_msg_count++;
				printk("ERROR: latency message nr. %d failed.\nTotal lost messages: %d \n", j, lost_msg_count);
			}
			else{
				/* Response is received. Record new time-stamp */
				in_time = k_uptime_get();
			}

			rtt = in_time - out_time;
			printk("Round-trip time: %lld \n", rtt);

			// DO: send response over ethernet...
		} 
	} 
	return err;
}

////////////////////////////////////////////////////////////////////////////
///////////////////////// NODE INITIALIZATION //////////////////////////////
////////////////////////////////////////////////////////////////////////////

int latency_test_init(){

    int err;

    err = fetch_own_mac();
    if (err){
        printk("Error printing network info\n");
    }
    else{
        printf("\nMAC address: %u:%u:%u:%u:%u:%u\n", \
        own_mac[0], own_mac[1], own_mac[2], own_mac[3], own_mac[4], own_mac[5]);
    }

    err = set_unicast_addr(&own_addr, own_mac);
    if (err){
        printk("Failed to set Unicast Address\n");
    }
    printk("Unicast address: %u\n", own_addr);

    err = set_dev_key(dev_key);
    if (err){
        printk("Failed to set Device Key\n");
    }

///////////////////////////////////////////////////////////////////

    // if (bt_mesh_is_provisioned()){
    //     printk("Node is already provisioned!\n ");
    // }else{
    //     err = bt_mesh_provision(net_key, net_idx, 0, 0, 1, dev_key);
    //     if (err == -EALREADY) {
	// 	    printk("Using stored settings\n");
	//     } else if (err) {
	// 	    printk("Provisioning failed (err %d)\n", err);
	// 	    return err;
	//     } else {
	// 	    printk("Provisioning completed\n");
	//     }
    // }

    // err = bt_mesh_cfg_app_key_add(net_idx, own_addr, net_idx, app_idx, app_key, NULL);
    // if (err < 0) {
    //             printk("Failed to add application key\n");
    //         }

    // err = bt_mesh_cfg_mod_app_bind(net_idx, own_addr, 0 , app_idx,
    //                             BT_MESH_MODEL_ID_SETTINGS_SRV, NULL);
    //         if (err < 0) {
    //             printk("Failed to bind application\n");
    //         }

    // /* Tester node will also be using the cfg client model */
    // if (mac_addresses_are_equal(own_mac, mac_addr_test_node)){
    //     role = TESTER_N;

    //     err = bt_mesh_cfg_mod_app_bind(net_idx, own_addr, 0, app_idx,
    //                             BT_MESH_MODEL_ID_SETTINGS_CLI, NULL);
    //     if (err < 0) {
    //         printk("Failed to bind application\n");
    //     }
    // }
    // else{
    //     role = FIELD_N;
    // }

    return err;
}
```

## src/model_handler.c
```c
/*
 * Copyright (c) 2021 Nordic Semiconductor ASA
 *
 * SPDX-License-Identifier: LicenseRef-BSD-5-Clause-Nordic
 */
/**
 * @file
 * @brief Model handler for the TX POWER CONTROL Server.
 *
 * Instantiates a Settings Client model for each button on the devkit, as
 * well as the standard Config and Health Server models. Handles all application
 * behavior related to the models.
 */

#include <zephyr/types.h>
#include <stddef.h>
#include <sys/printk.h>
#include <sys/util.h>
#include <sys/byteorder.h>
#include <stdio.h>
#include <stdint.h>
#include <stdbool.h>
#include <string.h>

#include <bluetooth/bluetooth.h>
#include <bluetooth/hci.h>
#include <bluetooth/hci_vs.h>

#include <bluetooth/conn.h>
#include <bluetooth/uuid.h>
#include <bluetooth/gatt.h>
#include <bluetooth/services/hrs.h>

#include <bluetooth/mesh.h>
#include <bluetooth/mesh/models.h>
#include <bluetooth/mesh/dk_prov.h>
#include <dk_buttons_and_leds.h>

#include <shell/shell.h>
#include <shell/shell_uart.h>

#include "wizchip_conf.h"

#include "settings.h"
#include "settings_srv.h"
#include "settings_cli.h"
#include "latency_test.h"
#include "model_handler.h"

#include <logging/log.h>
LOG_MODULE_DECLARE(test);

static const struct shell *test_shell;

static const struct bt_mesh_settings_srv_handlers settings_handlers = {
	// .get =
	// .set = 

	// no work...
};

static void status_handler(struct bt_mesh_settings_cli *cli,
			   struct bt_mesh_msg_ctx *ctx,
			   const struct bt_mesh_settings_status *status);

static struct bt_mesh_settings_srv srv = BT_MESH_SETTINGS_SRV_INIT(&settings_handlers);
static struct bt_mesh_settings_cli cli = BT_MESH_SETTINGS_CLI_INIT(&status_handler);

static void status_handler(struct bt_mesh_settings_cli *cli,
			   struct bt_mesh_msg_ctx *ctx,
			   const struct bt_mesh_settings_status *status){

				   // no work...
			   }

////////////////////////////////////////////////////////////////////////////
///////////////////////// HEALTH SERVER SETUP //////////////////////////////
////////////////////////////////////////////////////////////////////////////

/* Set up a repeating delayed work to blink the DK's LEDs when attention is
 * requested.
 */
static struct k_delayed_work attention_blink_work;

static void attention_blink(struct k_work *work)
{
	static int idx;
	const uint8_t pattern[] = {
		BIT(0) | BIT(1),
		BIT(1) | BIT(2),
		BIT(2) | BIT(3),
		BIT(3) | BIT(0),
	};

	dk_set_leds(pattern[idx++ % ARRAY_SIZE(pattern)]);
	k_delayed_work_submit(&attention_blink_work, K_MSEC(30));
}

static void attention_on(struct bt_mesh_model *mod)
{
	k_delayed_work_submit(&attention_blink_work, K_NO_WAIT);
}

static void attention_off(struct bt_mesh_model *mod)
{
	k_delayed_work_cancel(&attention_blink_work);
	dk_set_leds(DK_NO_LEDS_MSK);
}

static const struct bt_mesh_health_srv_cb health_srv_cb = {
	.attn_on = attention_on,
	.attn_off = attention_off,
};

static struct bt_mesh_health_srv health_srv = {
	.cb = &health_srv_cb,
};

BT_MESH_HEALTH_PUB_DEFINE(health_pub, 0);

////////////////////////////////////////////////////////////////////////////
///////////////////////// MODEL SETUP //////////////////////////////////////
////////////////////////////////////////////////////////////////////////////

static struct bt_mesh_cfg_cli cfg_cli = {
};

static struct bt_mesh_elem elements[] = {
	BT_MESH_ELEM(1,
		    BT_MESH_MODEL_LIST(
				 BT_MESH_MODEL_CFG_SRV,
				 BT_MESH_MODEL_CFG_CLI (&cfg_cli),
				 BT_MESH_MODEL_HEALTH_SRV(&health_srv, &health_pub)),
			BT_MESH_MODEL_LIST(BT_MESH_MODEL_SETTINGS_SRV(&srv), 
			BT_MESH_MODEL_SETTINGS_CLI(&cli))),
};

static const struct bt_mesh_comp comp = {
	.cid = BT_MESH_NORDIC_SEMI_COMPANY_ID,
	.elem = elements,
	.elem_count = ARRAY_SIZE(elements),
};

const struct bt_mesh_comp *model_handler_init(void)
{
	k_delayed_work_init(&attention_blink_work, attention_blink);

	test_shell = shell_backend_uart_get_ptr();
	shell_print(test_shell, ">>> Bluetooth Mesh Tester sample <<<");

	return &comp;
}

////////////////////////////////////////////////////////////////////////////
/////////////////////////////// DNU; RUN TEST SHELL ////////////////////////
////////////////////////////////////////////////////////////////////////////

/*COMMANDS:

test run latency
test run scalability
....*/

static int cmd_run_latency(const struct shell *shell, size_t argc, char *argv[]){
	
	int err = 0;
	err = latency_test_init();
	
	if(err){
		printk("ERROR: Failed to initialize Latency Test \n");}
	else{
		printk("Latency test initialized \n");}

	err = latency_test_run();
	
	dk_set_led(1, true);

	return err;
}

static int cmd_run_scalability(const struct shell *shell, size_t argc, char *argv[]){
	
	int err = 0; 
	// err = scalability_test();
	dk_set_led(1, false);

	return err;
}

/* Run (test) commands */
SHELL_STATIC_SUBCMD_SET_CREATE(run_cmds,
	SHELL_CMD_ARG(latency, NULL,
		      "Starting Latency Test...",
		      cmd_run_latency, 1, 0),
	SHELL_CMD_ARG(scalability, NULL,
		      "Starting Scalability Test...",
		      cmd_run_scalability, 1, 0),
	SHELL_SUBCMD_SET_END
);

////////////////////////////////////////////////////////////////////////////
//////////////////////////////// DNU; CONFIG TEST SHELL ////////////////////
////////////////////////////////////////////////////////////////////////////

/*COMMANDS:

test cfg app_key
test cfg bind
....*/

static int cmd_app_key(const struct shell *shell, size_t argc, char *argv[])
{
    uint16_t addr;
	uint16_t app_key;
	int err;

	addr = strtol(argv[1], NULL, 0);
	app_key = addr; // only for testing! Remove!
	
	shell_print(shell, "Sending app key config message...", argv[1]);
	
	// struct bt_mesh_test_config_msg *msg;
	// struct bt_mesh_settings_srv *srv;

	// msg->cmd = APP_KEY;
	// srv->model
	// msg->app_key = 

	
	//err = bt_mesh_cfg_app_key_add(NULL, addr, NULL, 1, app_key, NULL);

	if (err) {
		//LOG_WRN("Failed to send config message: %d", err);
	}
 
    return 0;
}


static int cmd_bind_app(const struct shell *shell, size_t argc,
			    char *argv[])
{
	int err = 0;

	//err = bt_mesh_cfg_mod_app_bind(ADD ARGUMENTS);

	return err;
}

/* Configuration commands */
SHELL_STATIC_SUBCMD_SET_CREATE(cfg_cmds,
	SHELL_CMD_ARG(app_key, NULL,
		      "App key ...",
		      cmd_app_key, 1, 0),
	SHELL_CMD_ARG(bind, NULL,
		      "Bind ...",
		      cmd_bind_app, 1, 0),
	
	SHELL_SUBCMD_SET_END
);
///////////////////////////////////////////////////////////////////////////

static int cmd_test(const struct shell *shell, size_t argc, char **argv)
{
	if (argc == 1) {
		shell_help(shell);
		/* shell returns 1 when help is printed */
		return 1;
	}

	shell_error(shell, "%s unknown parameter: %s", argv[0], argv[1]);

	return -EINVAL;
}

SHELL_STATIC_SUBCMD_SET_CREATE(test_cmds,

	SHELL_CMD(run, &run_cmds, "Run test commands", cmd_test),
	SHELL_CMD(cfg, &cfg_cmds, "Run test commands", cmd_test),
	
	SHELL_SUBCMD_SET_END
);

SHELL_CMD_ARG_REGISTER(test, &test_cmds, "Bluetooth Mesh Test commands",
               cmd_test, 1, 1);
```
