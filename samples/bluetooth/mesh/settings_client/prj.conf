## CMakeLists.txt
```
#
# Copyright (c) 2021 Nordic Semiconductor ASA
#
# SPDX-License-Identifier: LicenseRef-BSD-5-Clause-Nordic
#
cmake_minimum_required(VERSION 3.13.1)

find_package(Zephyr REQUIRED HINTS $ENV{ZEPHYR_BASE})
project(NONE)

target_sources(app PRIVATE
	src/main.c
	src/model_handler.c
	src/settings_cli.c)
target_include_directories(app PRIVATE include)

zephyr_library_include_directories(
	${CMAKE_CURRENT_SOURCE_DIR}
	${NRF_DIR}/subsys/bluetooth/mesh)
```

## prj.conf
```kconfig
#
# Copyright (c) 2021 Nordic Semiconductor ASA
#
# SPDX-License-Identifier: LicenseRef-BSD-5-Clause-Nordic
#

# # Enable Zephyr application to be booted by MCUboot
# CONFIG_BOOTLOADER_MCUBOOT=y

# General configuration
CONFIG_MAIN_STACK_SIZE=4096
CONFIG_SYSTEM_WORKQUEUE_STACK_SIZE=4096
CONFIG_FLASH=y
CONFIG_FLASH_MAP=y
CONFIG_FCB=y
CONFIG_NVS=y
CONFIG_SETTINGS=y
CONFIG_HWINFO=y
CONFIG_ASSERT=y
CONFIG_ASSERT_LEVEL=2
CONFIG_LOG=y
CONFIG_LOG_PRINTK=y

CONFIG_DK_LIBRARY=y
CONFIG_BT_MESH_DK_PROV=y

# Bluetooth configuration
CONFIG_BT=y
CONFIG_BT_COMPANY_ID=0x0059
CONFIG_BT_DEVICE_NAME="Mesh Settings Client"
CONFIG_BT_L2CAP_RX_MTU=69
CONFIG_BT_L2CAP_TX_MTU=69
CONFIG_BT_L2CAP_TX_BUF_COUNT=32
CONFIG_BT_LL_SW_SPLIT=y
CONFIG_BT_OBSERVER=y
CONFIG_BT_PERIPHERAL=y
CONFIG_BT_SETTINGS=y
CONFIG_BT_TINYCRYPT_ECC=y

# Disable unused Bluetooth features
CONFIG_BT_CTLR_DUP_FILTER_LEN=0
CONFIG_BT_CTLR_LE_ENC=n
CONFIG_BT_DATA_LEN_UPDATE=n
CONFIG_BT_PHY_UPDATE=n
CONFIG_BT_CTLR_CHAN_SEL_2=n
CONFIG_BT_CTLR_MIN_USED_CHAN=n
CONFIG_BT_CTLR_PRIVACY=n

# Bluetooth Mesh configuration
CONFIG_BT_MESH=y
CONFIG_BT_MESH_RELAY=y
CONFIG_BT_MESH_FRIEND=y
CONFIG_BT_MESH_ADV_BUF_COUNT=64
CONFIG_BT_MESH_TX_SEG_MAX=32
CONFIG_BT_MESH_PB_GATT=y
CONFIG_BT_MESH_GATT_PROXY=y

# # WIZnet W5500 SPI
# CONFIG_SPI=y
# CONFIG_SPI_0=y

# # DFU
# CONFIG_IMG_MANAGER=y
# CONFIG_IMG_ERASE_PROGRESSIVELY=y
# CONFIG_DFU_TARGET=y

# Debugging
# CONFIG_DEBUG=y
# CONFIG_LOG_BUFFER_SIZE=16000
# CONFIG_SEGGER_RTT_BUFFER_SIZE_UP=4096
```

## src/main.c
```c
/*
 * Copyright (c) 2021 Nordic Semiconductor ASA
 *
 * SPDX-License-Identifier: LicenseRef-BSD-5-Clause-Nordic
 */

/** @file
 *  @brief Nordic Mesh light sample
 */
#include <bluetooth/bluetooth.h>
#include <bluetooth/mesh/models.h>
#include <bluetooth/mesh/dk_prov.h>
#include <dk_buttons_and_leds.h>
#include <zephyr.h>

#include "model_handler.h"

/////////////////////////////// MESH INIT ///////////////////////////////

static void bt_ready(int err)
{
	if (err) {
		printk("Bluetooth init failed (err %d)\n", err);
		return;
	}

	printk("Bluetooth initialized\n");

	dk_leds_init();
	dk_buttons_init(NULL);

	err = bt_mesh_init(bt_mesh_dk_prov_init(), model_handler_init());
	if (err) {
		printk("Initializing mesh failed (err %d)\n", err);
		return;
	}

	if (IS_ENABLED(CONFIG_SETTINGS)) {
		settings_load();
	}

	/* This will be a no-op if settings_load() loaded provisioning info */
	bt_mesh_prov_enable(BT_MESH_PROV_ADV | BT_MESH_PROV_GATT);

	printk("Mesh initialized\n");
}

void main(void)
{
	int err;

	printk("Initializing Bluetooth...\n");

	err = bt_enable(bt_ready);
	if (err) {
		printk("Bluetooth init failed (err %d)\n", err);
	}
}
```

## include/ethernet_command_system.h
```c
/*
 * Copyright (c) 2021 Nordic Semiconductor ASA
 *
 * SPDX-License-Identifier: LicenseRef-BSD-5-Clause-Nordic
 */

#ifndef ETHERNET_COMMAND_SYSTEM_H
#define ETHERNET_COMMAND_SYSTEM_H

#include <stdio.h>
#include <stdint.h>
#include <stdbool.h>
#include <string.h>

enum ethernet_ctrl_cmd {
	CMD_RESET = 0x01,
	CMD_I_AM_ALIVE = 0x02,
	CMD_DFU = 0x03,
	CMD_LED = 0x04,
	CMD_TXP = 0x05, // SA
};

struct __attribute((packed)) ethernet_reset_package {
	bool is_broadcast;
	uint8_t target_mac[6];
};

struct __attribute((packed)) ethernet_i_am_alive_package {
	uint8_t ip[4];
	uint8_t mac[6];
	uint8_t version;
};

struct __attribute((packed)) ethernet_dfu_package {
	bool is_broadcast;
	uint8_t target_mac[6];
};

struct __attribute((packed)) ethernet_led_package {
	bool is_broadcast;
	bool on_off;
	uint8_t target_mac[6];
};

struct __attribute((packed)) ethernet_txp_package { // SA
	bool is_broadcast;
	int8_t tx_power;
	uint8_t target_mac[6];
};

struct __attribute((packed)) command_system_package {
	uint32_t identifier;
	uint8_t opcode;
	uint8_t mac[6];
	union {
		struct ethernet_reset_package reset_package;
		struct ethernet_i_am_alive_package i_am_alive_package;
		struct ethernet_dfu_package dfu_package;
		struct ethernet_led_package led_package;
		struct ethernet_txp_package txp_package; // SA
	} payload;
};

void ethernet_command_system_rx(void);

void send_over_ethernet(uint8_t *payload_package, uint8_t opcode);

void ethernet_command_system_init(void);

#endif // ETHERNET_COMMAND_SYSTEM_H
```

## include/model_handler.h
```c
/*
 * Copyright (c) 2021 Nordic Semiconductor ASA
 *
 * SPDX-License-Identifier: LicenseRef-BSD-5-Clause-Nordic
 */

/**
 * @file
 * @brief Model handler
 */

#ifndef MODEL_HANDLER_H__
#define MODEL_HANDLER_H__

#include <bluetooth/mesh.h>

#ifdef __cplusplus
extern "C" {
#endif

const struct bt_mesh_comp *model_handler_init(void);

#ifdef __cplusplus
}
#endif

#endif /* MODEL_HANDLER_H__ */
```

## include/settings.h
```c
/*
 * Copyright (c) 2021 Nordic Semiconductor ASA
 *
 * SPDX-License-Identifier: LicenseRef-BSD-5-Clause-Nordic
 */

/** @file
 *  @defgroup bt_mesh_settings Device Settings Models
 *  @{
 *  @brief API for the Device Settings Model.
 */

#ifndef BT_MESH_SETTINGS_H__
#define BT_MESH_SETTINGS_H__

#include <stdlib.h>
#include <bluetooth/mesh/models.h>
#include <bluetooth/mesh/model_types.h>

#ifdef __cplusplus
extern "C" {
#endif

#define BT_MESH_NORDIC_SEMI_COMPANY_ID 0x0059
#define BT_MESH_MODEL_ID_SETTINGS_CLI 0x0005
#define BT_MESH_MODEL_ID_SETTINGS_SRV 0x0006

#define BT_MESH_DEVICE_SETTINGS_GET_OP \
		BT_MESH_MODEL_OP_3(0xC1, BT_MESH_NORDIC_SEMI_COMPANY_ID)

#define BT_MESH_DEVICE_SETTINGS_SET_OP \
		BT_MESH_MODEL_OP_3(0xC2, BT_MESH_NORDIC_SEMI_COMPANY_ID)

#define BT_MESH_DEVICE_SETTINGS_STATUS_OP \
		BT_MESH_MODEL_OP_3(0xC3, BT_MESH_NORDIC_SEMI_COMPANY_ID)


#define BT_MESH_DEVICE_SETTINGS_MSG_LEN_GET 0 
#define BT_MESH_DEVICE_SETTINGS_MSG_MINLEN_SET 1
#define BT_MESH_DEVICE_SETTINGS_MSG_MAXLEN_SET 5
#define BT_MESH_DEVICE_SETTINGS_MSG_MINLEN_STATUS 1
#define BT_MESH_DEVICE_SETTINGS_MSG_MAXLEN_STATUS 2

/** Mandatory parameters for the Settings Set message. */
struct bt_mesh_settings_set {
	/** TX Power to set on server */
	int8_t txp_value;
};

/** Parameters for the Settings Status message. */
struct bt_mesh_settings_status {
	/** Success / Failure status of Set message */
	bool status;
	/** The present value of the Settings state. */
    int8_t present_txp;
};

#ifdef __cplusplus
}
#endif

/** @} */

#endif /* BT_MESH_SETTINGS_H__ */
```

## include/settings_cli.h
```c
/*
 * Copyright (c) 2021 Nordic Semiconductor ASA
 *
 * SPDX-License-Identifier: LicenseRef-BSD-5-Clause-Nordic
 */

/** @file
 *  @defgroup bt_mesh_settings_cli Device Settings Client model
 *  @{
 *  @brief API for the Device Settings Client model.
 */

#ifndef BT_MESH_SETTINGS_CLI_H__
#define BT_MESH_SETTINGS_CLI_H__

#include <bluetooth/mesh/model_types.h>
#include "settings.h"

#ifdef __cplusplus
extern "C" {
#endif

extern const struct bt_mesh_model_op _bt_mesh_settings_cli_op[];
extern const struct bt_mesh_model_cb _bt_mesh_settings_cli_cb;


struct bt_mesh_settings_cli;

/** @def BT_MESH_SETTINGS_CLI_INIT
 *
 * @brief Initialization parameters for a bt_mesh_settings_cli instance.
 *
 * @param[in] _status_handler Status message handler.
 */
#define BT_MESH_SETTINGS_CLI_INIT(_status_handler)						\
	{																	\
		.status_handler = _status_handler,								\
		.pub = {.msg = NET_BUF_SIMPLE(BT_MESH_MODEL_BUF_LEN(			\
				BT_MESH_DEVICE_SETTINGS_SET_OP,							\
				BT_MESH_DEVICE_SETTINGS_MSG_MAXLEN_SET)) }				\
	}


/** @def BT_MESH_MODEL_SETTINGS_CLI
 *
 * @brief Device Settings Client model composition data entry.
 *
 * @param[in] _cli Pointer to a bt_mesh_settings_cli instance.
 */
#define BT_MESH_MODEL_SETTINGS_CLI(_cli) BT_MESH_MODEL_VND_CB(					\
        BT_MESH_NORDIC_SEMI_COMPANY_ID, BT_MESH_MODEL_ID_SETTINGS_CLI,			\
        _bt_mesh_settings_cli_op, &(_cli)->pub,									\
        BT_MESH_MODEL_USER_DATA(struct bt_mesh_settings_cli, _cli),				\
        &_bt_mesh_settings_cli_cb)

/**
 * Settings Client structure.
 *
 * Should be initialized with the BT_MESH_SETTINGS_CLI_INIT macro.
 */
struct bt_mesh_settings_cli {
	/** @brief Settings status message handler.
	 *
	 * @param[in] cli Client that received the status message.
	 * @param[in] ctx Context of the incoming message.
	 * @param[in] status TXP Status of the Settings Server that
	 * published the message.
	 */
	void (*const status_handler)(struct bt_mesh_settings_cli *cli,
				     struct bt_mesh_msg_ctx *ctx,
				     const struct bt_mesh_settings_status *status);
	/** Current Transaction ID. */
	uint8_t tid;
	/** Response context for tracking acknowledged messages. */
	struct bt_mesh_model_ack_ctx ack_ctx;
	/** Publish parameters. */
	struct bt_mesh_model_pub pub;
	/** Access model pointer. */
	struct bt_mesh_model *model;
};

// void status_handler(struct bt_mesh_settings_cli *cli,
//  			   struct bt_mesh_msg_ctx *ctx,
//  			   const struct bt_mesh_settings_status *status);

int bt_mesh_settings_cli_get(struct bt_mesh_settings_cli *cli,
			  struct bt_mesh_msg_ctx *ctx,
			  struct bt_mesh_settings_status *rsp);

int bt_mesh_settings_cli_set(struct bt_mesh_settings_cli *cli,
			  struct bt_mesh_msg_ctx *ctx,
			  const struct bt_mesh_settings_set *set,
			  struct bt_mesh_settings_status *rsp);

/** @cond INTERNAL_HIDDEN */
extern const struct bt_mesh_model_op _bt_mesh_settings_cli_op[];
extern const struct bt_mesh_model_cb _bt_mesh_settings_cli_cb;
/** @endcond */

#ifdef __cplusplus
}
#endif

/** @} */

#endif /* BT_MESH_SETTINGS_CLI_H__ */
```

## src/ethernet_command_system.c
```c
/*
 * Copyright (c) 2021 Nordic Semiconductor ASA
 *
 * SPDX-License-Identifier: LicenseRef-BSD-5-Clause-Nordic
 */

#include <zephyr.h>

#include "ethernet_command_system.h"
#include "pca20036_ethernet.h"
#include "w5500.h"
#include "socket.h"
#include "ethernet_utils.h"
#include "hp_led.h"
#include "ethernet_dfu.h"

static struct k_delayed_work i_am_alive_work;

static uint8_t received_data[200];
static struct command_system_package received_package;

static uint16_t cmd_rx_port = RX_PORT;
static uint8_t own_mac[6];
static uint8_t own_ip[4];
static uint8_t server_ip[4];

static void i_am_alive_work_handler(struct k_work *work)
{
	struct ethernet_i_am_alive_package i_am_alive_package;

	get_own_ip((uint8_t *)&i_am_alive_package.ip);
	get_own_mac((uint8_t *)&i_am_alive_package.mac);
	i_am_alive_package.version = DFU_APP_VERSION;

	send_over_ethernet((uint8_t *)&i_am_alive_package, CMD_I_AM_ALIVE);

	k_delayed_work_submit(&i_am_alive_work, K_MSEC(5000));
}

static void i_am_alive_work_init_start(void)
{
	k_delayed_work_init(&i_am_alive_work, i_am_alive_work_handler);
	k_delayed_work_submit(&i_am_alive_work, K_NO_WAIT);
}

void ethernet_command_system_rx(void)
{
	while (getSn_RX_RSR(SOCKET_RX) != 0x00) {
		get_own_ip(own_ip);

		int32_t recv_len = recvfrom(SOCKET_RX, received_data,
					    sizeof(received_data), server_ip,
					    &cmd_rx_port);

		if (recv_len >= 4) // 4 because of the first memcpy
		{
			uint32_t identifier;
			memcpy(&identifier, received_data, 4);

			if (identifier == 0xDEADFACE) {
				memcpy(&received_package, received_data,
				       sizeof(received_package));
				// void * memcpy ( void * destination, const void * source, size_t num );

				switch (received_package.opcode) {
				case CMD_RESET:
					if (received_package.payload
						    .reset_package
						    .is_broadcast ||
					    mac_addresses_are_equal(
						    own_mac,
						    received_package.payload
							    .reset_package
							    .target_mac)) {
						printk("CMD: Reset node\n");
						NVIC_SystemReset();
					}
					break;
				case CMD_DFU: ///////////////////////
					if (received_package.payload.dfu_package
						    .is_broadcast ||
					    mac_addresses_are_equal(
						    own_mac,
						    received_package.payload
							    .dfu_package
							    .target_mac)) {
						ethernet_dfu_start(server_ip);
					}
					break;
				case CMD_LED:
					if (received_package.payload.led_package
						    .is_broadcast ||
					    mac_addresses_are_equal(
						    own_mac,
						    received_package.payload
							    .led_package
							    .target_mac)) {
						if (received_package.payload
							    .led_package
							    .on_off) {
							printk("CMD: HP LED ON\n");
							hp_led_on();
						} else {
							printk("CMD: HP LED OFF\n");
							hp_led_off();
						}
					}
					break;
				default:
					printk("CMD: Unrecognized control command: %d\n",
					       received_package.opcode);
					break;
				}
			}
		}
	}
}

void send_over_ethernet(uint8_t *payload_package, uint8_t opcode)
{
	struct command_system_package package;
	package.identifier = 0xDEADFACE;
	package.opcode = opcode;
	get_own_mac((uint8_t *)&package.mac);

	bool send_package = true;

	switch (opcode) {
	case CMD_I_AM_ALIVE: {
		struct ethernet_i_am_alive_package i_am_alive_package;
		memcpy(&i_am_alive_package, payload_package,
		       sizeof(struct ethernet_i_am_alive_package));
		package.payload.i_am_alive_package = i_am_alive_package;
		break;
	}
	default:
		printk("send_over_ethernet: Unknown package type chosen\n");
		send_package = false;
		break;
	}

	if (send_package) {
		int32_t err = sendto(SOCKET_TX, (uint8_t *)&package,
				     sizeof(struct command_system_package),
				     (uint8_t *)TX_IP, TX_PORT);

		if (err < 0) {
			printk("Error sending packet - error code: %d\n", err);
		}
	}
}

void ethernet_command_system_init(void)
{
	get_own_mac(own_mac);
	i_am_alive_work_init_start();
}
```

## src/latency_test.c
```c
// move to model_handler? 

#include <stdio.h>
#include <stdint.h>
#include <stdbool.h>
#include <string.h>

#include <bluetooth/bluetooth.h>
#include <bluetooth/mesh/models.h>
#include "settings.h"
#include "pca20036_ethernet.h" // get_own_ utils
#include "ethernet_utils.h" // _are_equal utils
#include "../../../../zephyr/subsys/bluetooth/mesh/prov.h"
#include "../../../../zephyr/include/bluetooth/mesh/cfg_cli.h"

/* CLIENT:

// on boot: check rolle

// SENDING MESSAGES:
for (all addresses) {
    // get address
    for (i < 50, i++){
        // save timestamp for outgoing message
        // send unicast-message
        // wait for response
    }

}

// RECEIVING MESSAGES:

    message_handler{
        // save timestamp
        // check sequence number
            // compare timestamps
            // calculate rrt and save to file
    }

*/

///////////////////////// DRAFT OF TEST IMPLM ////////////////////////

#define MSG_AMOUNT 50
#define NODES_TOTAL 3

static uint8_t transmitt_value;

static uint8_t own_mac[6];

static uint8_t mac_addr_test_node[6] = {0xB0, 0xAE, 0xD4, 0xDA, 0x35, 0x43};

uint8_t addr_arr[NODES_TOTAL][6] = {
    {0xB0, 0xAE, 0xD4, 0xDA, 0x35, 0x43},
    {0x00, 0x00, 0x00, 0x00, 0x00, 0x00}, 
    {0x00, 0x00, 0x00, 0x00, 0x00, 0x00}
};

uint8_t target_addr[6];
uint16_t uni_addr;

static struct bt_mesh_settings_cli settings_cli = BT_MESH_SETTINGS_CLI_TEST_INIT(&latency_resp_handler);

struct bt_mesh_settings_latency latency_msg;

void start_latency_test (void){

int err;

    for (int i = 0; i < len(addr_arr); ++i) {

        /* Fill inn current mac address*/
        for (int j = 0; j < 6; ++j) {
            
            target_addr[j] = addr_arr[i][j];
            latency_msg.target_mac = target_addr;
            }

        /* Send flood of messages to unicast address */
        for (int k = 0; i < MSG_AMOUNT; ++k) {

            //latency_msg.seq_num = new_seq_num;

            err = send_latency_test_msg(&settings_cli, &uni_addr, &latency_msg);
            if (err){
                printk("ERROR: latency message failed. \n");
                }
            else{
                //save_time_stamp(new_seq_num);
                }
        
            }

    }
}

static void save_time_stamp(uint8_t seq_num){
    
    // DO: use k_uptime_get()
}

static int send_latency_test_msg(struct bt_mesh_settings_cli *cli, uint16_t addr, struct bt_mesh_settings_latency *msg){

    struct bt_mesh_msg_ctx ctx = {
            .addr = addr, // unicast address. Set during prov.
            .send_ttl = BT_MESH_TTL_DEFAULT, // needs to be set dynamically during runtime
    };

    BT_MESH_MODEL_BUF_DEFINE(buf, BT_MESH_DEVICE_SETTINGS_LATENCY_OP, BT_MESH_DEVICE_SETTINGS_MSG_LEN_LATENCY);
    bt_mesh_model_msg_init(&buf, BT_MESH_DEVICE_SETTINGS_LATENCY_OP);

    // Add sequence number to buffer
    net_buf_simple_add_u8(&buf, msg->target_mac);
    net_buf_simple_add_u8(&buf, msg->seq_num);

    return bt_mesh_model_send(&cli, &ctx, &buf, NULL, NULL);

}


static void latency_resp_handler(struct bt_mesh_model *model,
                                  struct bt_mesh_msg_ctx *ctx,
                                  struct net_buf_simple *buf)
{

    if (buf->len != BT_MESH_DEVICE_SETTINGS_MSG_LEN_LATENCY) {
			printk("Error: Buffer length out of scope (handle_latency)");
		return;
	}


}



/**
 * Returns true if the specified address is an address of the local element.
 */
static bool address_is_local(struct bt_mesh_model *mod, uint16_t addr)
{
	return bt_mesh_model_elem(mod)->addr == addr;
}

/**
 * Returns true if the provided address is unicast address.
 */
static bool address_is_unicast(uint16_t addr)
{
	return (addr > 0) && (addr <= 0x7FFF);
}

static int define_unicast_addr(){
    int err;

    get_own_mac(own_mac);
    // left shift mac address by two spaces


    //err = !(address_is_unicast());
    return err;
};

/*  */

static int define_unicast_addr(){
    int err;

    get_own_mac(own_mac);
    for (int i = 0; i < 6; ++i){
        uni_addr[i] = own_mac[i];
    }
    // left shift mac address by two spaces


    //err = !(address_is_unicast());
    return err;
};


static struct Node_data{
    uint8_t mac_address[6];
    uint8_t ttl;
};

/* Hard-coded TTL values for each MAC address */
static struct Node_data mac_to_ttl_value[NODES_TOTAL] = {
    {{0xB0, 0xAE, 0xD4, 0xDA, 0x35, 0x43}, 1},
    {{0xDE, 0xAD, 0xFA, 0xCE, 0x00, 0x00}, 2}
    };

static int init_node(enum Role role){

    int err;

    switch (role) {
        case TESTER_N:

        // set parameters

        return;

        case FIELD_N:
    
        for (int i = 0; i < NODES_TOTAL; i++){
            if (mac_addresses_are_equal(mac_to_ttl_value[i].mac_address, own_mac)){
                bt_mesh_cfg_ttl_set(NULL, uni_addr, mac_to_ttl_value[i].ttl, NULL);
                break;
            }
        }
        
        err = bt_mesh_cfg_net_transmit_set(NULL, uni_addr, transmitt_value, NULL);
        
        // err = bt_mesh_cfg_relay_set(NULL, uni_addr, ....);
        return;

        default:
        err = 1;;

    return err;


    }

};

/* Role of node in network.
The TESTER node is responsible for sending messages to and receiving from the other FIELD noed in the network. 
The TESTER node calculates RRT and logs the results using ethernet.
Tge FIELD node only responds to incoming messages  */
static enum Role {TESTER_N, FIELD_N};

/* Initialize node and set up parameters */
static void init_latency_test(){

    get_own_mac(own_mac);

    if (mac_addresses_are_equal(own_mac, mac_addr_test_node)){
        init_node(TESTER_N);
    }
    else{
        init_node(FIELD_N);
    }
}
```

## src/model_handler.c
```c
/*
 * Copyright (c) 2021 Nordic Semiconductor ASA
 *
 * SPDX-License-Identifier: LicenseRef-BSD-5-Clause-Nordic
 */
/**
 * @file
 * @brief Model handler for the Settings Client.
 *
 */
#include <bluetooth/bluetooth.h>
#include <bluetooth/mesh/models.h>
#include <dk_buttons_and_leds.h>

#include "settings_cli.h"

#define DEVICE_TXPOWER_NUM  7

static const int8_t txp[DEVICE_TXPOWER_NUM] = {-40, -20, -16, -8, -4, 0, 4};

/** TX Power is initiallized at 0 dB */
int txp_index = DEVICE_TXPOWER_NUM - 2;

static void status_handler(struct bt_mesh_settings_cli *cli,
 			   struct bt_mesh_msg_ctx *ctx,
 			   const struct bt_mesh_settings_status *status);

static struct bt_mesh_settings_cli settings_cli = BT_MESH_SETTINGS_CLI_INIT(&status_handler);

static void status_handler(struct bt_mesh_settings_cli *cli,
			   struct bt_mesh_msg_ctx *ctx,
			   const struct bt_mesh_settings_status *status)
{
	if (status->status == true){
	printk("Operation was successful. Current TX Power is %d dB\n",
	       status->present_txp);
	}
	else{
		printk("Set operation failed.\n");
		}
}

static int increment(int *txp_index){
	if (*txp_index == DEVICE_TXPOWER_NUM-1){
		return 1;
		}
	else{
		int p;
		p = *txp_index;
		p++;
		*txp_index = p;
		}
	return 0;
}

static int decrement(int *txp_index){
	if (*txp_index == 0){
		return 1;
		}
	else{
		int p;
		p = *txp_index;
		p--;
		*txp_index = p;
		}
	return 0;
}

static void button_handler_cb(uint32_t pressed, uint32_t changed)
{
	if (!bt_mesh_is_provisioned()) {
		return;
	}

	int err;
	for (int i = 0; i < 4; ++i) { 
		if (!(pressed & changed & BIT(i))) {
			continue;
		}

		/** Button 1 (Increase TXP level on server) */
		if (i == 0){
			err = increment(&txp_index);
			if (err){
				printk("TX Power is currently on the highest level! \n");
				return;
			}
			printk("\nIncreasing TX Power to %d \n", txp[txp_index]);
		}

		/** Button 2 (Decrease TXP level on server) */
		else if (i == 1){
			err = decrement(&txp_index);
			if (err){
				printk("TX Power is currently on the lowest level! \n");
			return;
			}
			printk("\nDecreasing TX Power to %d \n", txp[txp_index]);
		}

		/** Button 3 (Get TX Power from server) */
		else if (i == 2){
			err = bt_mesh_settings_cli_get(&settings_cli, NULL, NULL);
			return;
		}

		else{
			return;
		}


		struct bt_mesh_settings_set set = {
		 	.txp_value = txp[txp_index],
		 };
		
		err = bt_mesh_settings_cli_set(&settings_cli,
							  NULL, &set, NULL);
	
		if (err) {
			printk("Settings %d set failed: %d\n", i + 1, err);
		}
	}
}

/* Set up a repeating delayed work to blink the DK's LEDs when attention is
 * requested.
 */
static struct k_delayed_work attention_blink_work;

static void attention_blink(struct k_work *work)
{
	static int idx;
	const uint8_t pattern[] = {
		BIT(0) | BIT(1),
		BIT(1) | BIT(2),
		BIT(2) | BIT(3),
		BIT(3) | BIT(0),
	};

	dk_set_leds(pattern[idx++ % ARRAY_SIZE(pattern)]);
	k_delayed_work_submit(&attention_blink_work, K_MSEC(30));
}

static void attention_on(struct bt_mesh_model *mod)
{
	k_delayed_work_submit(&attention_blink_work, K_NO_WAIT);
}

static void attention_off(struct bt_mesh_model *mod)
{
	k_delayed_work_cancel(&attention_blink_work);
	dk_set_leds(DK_NO_LEDS_MSK);
}

static const struct bt_mesh_health_srv_cb health_srv_cb = {
	.attn_on = attention_on,
	.attn_off = attention_off,
};

static struct bt_mesh_health_srv health_srv = {
	.cb = &health_srv_cb,
};

BT_MESH_HEALTH_PUB_DEFINE(health_pub, 0);

static struct bt_mesh_elem elements[] = {
	BT_MESH_ELEM(1,
		    BT_MESH_MODEL_LIST(
			     BT_MESH_MODEL_CFG_SRV,
			     BT_MESH_MODEL_HEALTH_SRV(&health_srv, &health_pub)),
			BT_MESH_MODEL_LIST(BT_MESH_MODEL_SETTINGS_CLI(&settings_cli))),
};

static const struct bt_mesh_comp comp = {
	.cid = BT_MESH_NORDIC_SEMI_COMPANY_ID,
	.elem = elements,
	.elem_count = ARRAY_SIZE(elements),
};

const struct bt_mesh_comp *model_handler_init(void)
{
	static struct button_handler button_handler = {
		.cb = button_handler_cb,
	};

	dk_button_handler_add(&button_handler);
	k_delayed_work_init(&attention_blink_work, attention_blink);

	return &comp;
}
```

## src/settings_cli.c
```c
/*
 * Copyright (c) 2021 Nordic Semiconductor ASA
 *
 * SPDX-License-Identifier: LicenseRef-BSD-5-Clause-Nordic
 */
#include <string.h>
#include <stdlib.h>
#include <bluetooth/mesh/models.h>
#include "model_utils.h"

#include "settings_cli.h"

static void handle_status(struct bt_mesh_model *model,
                                  struct bt_mesh_msg_ctx *ctx,
                                  struct net_buf_simple *buf)
{
	if (buf->len < BT_MESH_DEVICE_SETTINGS_MSG_MINLEN_STATUS ||
	    buf->len > BT_MESH_DEVICE_SETTINGS_MSG_MAXLEN_STATUS) {
			printk("Error: Buffer length out of scope (handle_status)");
		return;
	}
	printk("CLI: HANDLE STATUS\n");
	struct bt_mesh_settings_cli *cli = model->user_data;
	struct bt_mesh_settings_status status;

	status.present_txp = net_buf_simple_pull_u8(buf);
	
	if (buf->len == 2){
		status.status = net_buf_simple_pull_u8(buf);
	}

	if (model_ack_match(&cli->ack_ctx, BT_MESH_DEVICE_SETTINGS_STATUS_OP, ctx)) {
		struct bt_mesh_settings_status *rsp =
			(struct bt_mesh_settings_status *)cli->ack_ctx.user_data;

		*rsp = status;
		model_ack_rx(&cli->ack_ctx);
	}

	if (cli->status_handler) {
		cli->status_handler(cli, ctx, &status);
	}
}

const struct bt_mesh_model_op _bt_mesh_settings_cli_op[] = {
    { BT_MESH_DEVICE_SETTINGS_STATUS_OP,    BT_MESH_DEVICE_SETTINGS_MSG_MINLEN_STATUS,
		handle_status },
    BT_MESH_MODEL_OP_END,
};

static int bt_mesh_settings_cli_init(struct bt_mesh_model *model)
{
	struct bt_mesh_settings_cli *cli = model->user_data;

	cli->model = model;
	net_buf_simple_init(cli->pub.msg, 0);
	model_ack_init(&cli->ack_ctx);

	return 0;
}

const struct bt_mesh_model_cb _bt_mesh_settings_cli_cb = {
	.init = bt_mesh_settings_cli_init,
};

int bt_mesh_settings_cli_get(struct bt_mesh_settings_cli *cli,
			  struct bt_mesh_msg_ctx *ctx,
			  struct bt_mesh_settings_status *rsp) 
{
    BT_MESH_MODEL_BUF_DEFINE(msg, 
        BT_MESH_DEVICE_SETTINGS_GET_OP,
        BT_MESH_DEVICE_SETTINGS_MSG_LEN_GET);
		
    bt_mesh_model_msg_init(&msg, BT_MESH_DEVICE_SETTINGS_GET_OP);

	return model_ackd_send(cli->model, ctx, &msg,
			       rsp ? &cli->ack_ctx : NULL,
			       BT_MESH_DEVICE_SETTINGS_STATUS_OP, rsp);
}

// static struct bt_mesh_model_pub pub_ctx = {
//     .msg = NET_BUF_SIMPLE(BT_MESH_MODEL_BUF_LEN(BT_MESH_DEVICE_SETTINGS_SET_OP,
//                                                 BT_MESH_DEVICE_SETTINGS_MSG_MAXLEN_SET)),
// };

int bt_mesh_settings_cli_set(struct bt_mesh_settings_cli *cli,
			  struct bt_mesh_msg_ctx *ctx,
			  const struct bt_mesh_settings_set *set,
			  struct bt_mesh_settings_status *rsp)
{

	BT_MESH_MODEL_BUF_DEFINE(msg, BT_MESH_DEVICE_SETTINGS_SET_OP,
				 BT_MESH_DEVICE_SETTINGS_MSG_MAXLEN_SET);
	bt_mesh_model_msg_init(&msg, BT_MESH_DEVICE_SETTINGS_SET_OP);

	net_buf_simple_add_u8(&msg, set->txp_value);
	net_buf_simple_add_u8(&msg, cli->tid++);

	return model_ackd_send(cli->model, ctx, &msg,
			       rsp ? &cli->ack_ctx : NULL,
			       BT_MESH_DEVICE_SETTINGS_STATUS_OP, rsp);
}
```
