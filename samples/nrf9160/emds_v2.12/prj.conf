## CMakeLists.txt
```
#
# Copyright (c) 2018 Nordic Semiconductor ASA
#
# SPDX-License-Identifier: LicenseRef-Nordic-5-Clause
#

cmake_minimum_required(VERSION 3.20.0)

find_package(Zephyr REQUIRED HINTS $ENV{ZEPHYR_BASE})
project(mqtt-simple)

# NORDIC SDK APP START
target_sources(app PRIVATE src/main.c)
# NORDIC SDK APP END
```

## Kconfig
```
#
# Copyright (c) 2020 Nordic Semiconductor ASA
#
# SPDX-License-Identifier: LicenseRef-Nordic-5-Clause
#

menu "MQTT simple sample"
config MQTT_PUB_TOPIC
	string "MQTT publish topic"
	default "my/publish/topic"

config MQTT_SUB_TOPIC
	string "MQTT subscribe topic"
	default "my/subscribe/topic"

config MQTT_CLIENT_ID
	string "MQTT Client ID"
	help
	  Use a custom Client ID string. If not set, the client ID will be
	  generated based on IMEI number (for nRF9160 based targets) or
	  randomly (for other platforms).
	default ""

config MQTT_BROKER_HOSTNAME
	string "MQTT broker hostname"
	default "mqtt.eclipseprojects.io"

config MQTT_BROKER_PORT
	int "MQTT broker port"
	default 1883

config MQTT_MESSAGE_BUFFER_SIZE
	int "MQTT message buffer size"
	default 128

config MQTT_PAYLOAD_BUFFER_SIZE
	int "MQTT payload buffer size"
	default 128

config BUTTON_EVENT_PUBLISH_MSG
	string "The message to publish on a button event"
	default "Hello from nRF91 MQTT Simple Sample"

config BUTTON_EVENT_BTN_NUM
	int "The button number"
	default 1

config MQTT_RECONNECT_DELAY_S
	int "Seconds to delay before attempting to reconnect to the broker"
	default 60

config LTE_CONNECT_RETRY_DELAY_S
	int "Seconds to delay before attempting to retry LTE connection"
	default 120

config MQTT_TLS_SEC_TAG
	int "TLS credentials security tag"
	default 24

config MQTT_TLS_SESSION_CACHING
	bool "Enable TLS session caching"

config MQTT_TLS_PEER_VERIFY
	int "Set peer verification level"
	default 2
	help
		Set to 0 for VERIFY_NONE, 1 for VERIFY_OPTIONAL, and 2 for
		VERIFY_REQUIRED.

endmenu

menu "Zephyr Kernel"
source "Kconfig.zephyr"
endmenu



menuconfig EMDS
	bool "Emergency Data Storage [EXPERIMENTAL]"
	select EXPERIMENTAL
	depends on PARTITION_MANAGER_ENABLED
	depends on FLASH_MAP
	default n
	help
	  Enable Emergency Data Storage

if EMDS

config EMDS_SECTOR_COUNT
	int "Sector count of the emergency data storage area"
	default 1
	help
	  Number of sectors used for the emergency data storage area

config EMDS_THREAD_STACK_SIZE
	int "Stack size for the emergency data storage thread"
	default 500
	help
	  Size of the stack that is initialized by the emergency data storage

config EMDS_THREAD_PRIORITY
	int "Priority for the emergency data storage thread"
	default 0
	help
	  Cooperative priority for the emergency data storage thread. This will
	  be used through K_PRIO_COOP(x), that means higher value gives lower
	  priority.

config EMDS_FLASH_TIME_WRITE_ONE_WORD_US
	int "Time to write one word into flash"
	default 43
	help
	  Max time to write one word (4 bytes) in flash (in microseconds). This
	  value is dependent on the chip used, and should be checked against the
	  chip datasheet.

config EMDS_FLASH_TIME_ENTRY_OVERHEAD_US
	int "Time to schedule write of one entry"
	default 300
	help
	   Max time to prepare the write of each entry (in microseconds).

config EMDS_FLASH_TIME_BASE_OVERHEAD_US
	int "Time to schedule the store process"
	default 85000 if SETTINGS && !SOC_FLASH_NRF_PARTIAL_ERASE
	default 9000 if SETTINGS && SOC_FLASH_NRF_PARTIAL_ERASE
	default 500
	help
	   Max time to prepare the store process (in microseconds). If used
	   together with SETTINGS this value has to be at least as long as the
	   time to erase one page (ERASEPAGE). If used together with
	   SOC_FLASH_NRF_PARTIAL_ERASE this value should be
	   (SOC_FLASH_NRF_PARTIAL_ERASE_MS * 1000 * 3). This is to account for
	   worst case scenario, before starting storing entries. This value
	   is dependent on the chip used, and should be checked against the chip
	   datasheet.

endif # EMDS




module = MQTT_SIMPLE
module-str = MQTT Simple
source "${ZEPHYR_BASE}/subsys/logging/Kconfig.template.log_config"
```

## sample.yaml
```
sample:
  name: mqtt simple sample
tests:
  sample.nrf9160.mqtt_simple:
    build_only: true
    integration_platforms:
      - nrf9160dk_nrf9160_ns
    platform_allow: nrf9160dk_nrf9160_ns
    tags: ci_build
```

## prj.conf
```kconfig
#
# Copyright (c) 2020 Nordic Semiconductor ASA
#
# SPDX-License-Identifier: LicenseRef-Nordic-5-Clause
#

# Networking
# CONFIG_NETWORKING=y
# CONFIG_NET_NATIVE=n
# CONFIG_NET_SOCKETS_OFFLOAD=y
# CONFIG_NET_SOCKETS=y
# CONFIG_NET_SOCKETS_POSIX_NAMES=y

# # LTE link control
# CONFIG_LTE_LINK_CONTROL=y
# CONFIG_LTE_AUTO_INIT_AND_CONNECT=n

# # Modem library
# CONFIG_NRF_MODEM_LIB=y

# # MQTT
# CONFIG_MQTT_LIB=y
# CONFIG_MQTT_LIB_TLS=n
# CONFIG_MQTT_CLEAN_SESSION=y

# # Application
# CONFIG_MQTT_PUB_TOPIC="my/publish/topic"
# CONFIG_MQTT_SUB_TOPIC="my/subscribe/topic"
# CONFIG_MQTT_CLIENT_ID="my-client-id"
# CONFIG_MQTT_BROKER_HOSTNAME="mqtt.eclipseprojects.io"
# CONFIG_MQTT_BROKER_PORT=1883

# Enable logging
CONFIG_LOG=y
CONFIG_USE_SEGGER_RTT=y
CONFIG_RTT_CONSOLE=y
CONFIG_CBPRINTF_FP_SUPPORT=y

# Memory
CONFIG_MAIN_STACK_SIZE=4096
CONFIG_HEAP_MEM_POOL_SIZE=2048

# NewLib C
CONFIG_NEWLIB_LIBC=y

CONFIG_FLASH_PAGE_LAYOUT=y
CONFIG_EMDS_FLASH_TIME_BASE_OVERHEAD_US=87000
# CONFIG_EMDS_FLASH_TIME_BASE_OVERHEAD_US=6000

# CONFIG_SOC_FLASH_NRF_PARTIAL_ERASE=y
# CONFIG_SOC_FLASH_NRF_PARTIAL_ERASE_MS=2

########################################################

CONFIG_NCS_SAMPLES_DEFAULTS=y

# General configuration
CONFIG_SYSTEM_WORKQUEUE_STACK_SIZE=2048
CONFIG_FLASH=y
CONFIG_FLASH_MAP=y
CONFIG_NVS=y
CONFIG_SETTINGS=y
CONFIG_HWINFO=y
CONFIG_DK_LIBRARY=y
CONFIG_PWM=y
CONFIG_PARTITION_MANAGER_ENABLED=y
CONFIG_PM_SINGLE_IMAGE=y
CONFIG_PM_PARTITION_SIZE_SETTINGS_STORAGE=0x8000
CONFIG_HW_STACK_PROTECTION=y

# EMDS
CONFIG_EMDS=y
CONFIG_BT_MESH_RPL_STORAGE_MODE_EMDS=y

# Debugging
CONFIG_RESET_ON_FATAL_ERROR=n
# CONFIG_DEBUG_THREAD_INFO=y
CONFIG_LOG=y
CONFIG_ASSERT=y
CONFIG_LOG_MODE_MINIMAL=n
CONFIG_BT_DEBUG_LOG=y
CONFIG_LOG_DEFAULT_LEVEL=4

# Secure Partition Manager
# CONFIG_BUILD_WITH_TFM=n
# CONFIG_SPM=y
```

## overlay-carrier.conf
```kconfig
#
# Copyright (c) 2019 Nordic Semiconductor ASA
#
# SPDX-License-Identifier: LicenseRef-Nordic-5-Clause
#

CONFIG_LWM2M_CARRIER=y

# The library requires newlibc
CONFIG_NEWLIB_LIBC=y

# LwM2M carrier is only compiled for hard-float
CONFIG_FPU=y
CONFIG_FP_HARDABI=y

CONFIG_NRF_MODEM_LIB=y
CONFIG_NRF_MODEM_LIB_SYS_INIT=n

# LTE link control
CONFIG_LTE_LINK_CONTROL=y
# Disable autoconnect
CONFIG_LTE_AUTO_INIT_AND_CONNECT=n
# Disable NB-IoT fallback
CONFIG_LTE_NETWORK_USE_FALLBACK=n

# Download client for DFU
CONFIG_DOWNLOAD_CLIENT=y

# PDN management support
CONFIG_PDN_MANAGEMENT=y

# Credential management
CONFIG_MODEM_KEY_MGMT=y

# Non-volatile Storage
CONFIG_FLASH=y
CONFIG_FLASH_PAGE_LAYOUT=y
CONFIG_NVS=y
CONFIG_MPU_ALLOW_FLASH_WRITE=y

# Heap and stacks
CONFIG_HEAP_MEM_POOL_SIZE=16384

# General config
CONFIG_NETWORKING=y
CONFIG_NET_NATIVE=n
CONFIG_NET_SOCKETS=y
CONFIG_NET_SOCKETS_POSIX_NAMES=y
CONFIG_NET_SOCKETS_OFFLOAD=y

# Allow the non-secure application to request reboot
CONFIG_REBOOT=y
```

## overlay-qemu-x86-tls.conf
```kconfig
#
# Copyright (c) 2020 Nordic Semiconductor ASA
#
# SPDX-License-Identifier: LicenseRef-Nordic-5-Clause
#

# MQTT TLS
CONFIG_MQTT_LIB_TLS=y
CONFIG_MQTT_BROKER_PORT=8883

# MBED TLS
CONFIG_MBEDTLS=y
CONFIG_MBEDTLS_BUILTIN=y
CONFIG_MBEDTLS_ENABLE_HEAP=y
CONFIG_MBEDTLS_HEAP_SIZE=120000
CONFIG_MBEDTLS_SSL_MAX_CONTENT_LEN=16384
CONFIG_MBEDTLS_PEM_CERTIFICATE_FORMAT=y
CONFIG_MBEDTLS_KEY_EXCHANGE_RSA_ENABLED=y
CONFIG_MBEDTLS_MAC_SHA256_ENABLED=y

# NET SOCKETS
CONFIG_NET_SOCKETS_SOCKOPT_TLS=y
```

## overlay-tls.conf
```kconfig
#
# Copyright (c) 2020 Nordic Semiconductor ASA
#
# SPDX-License-Identifier: LicenseRef-Nordic-5-Clause
#

# MQTT TLS
CONFIG_MQTT_LIB_TLS=y
CONFIG_MQTT_BROKER_PORT=8883

# Modem key management, for provisioning certificates
CONFIG_MODEM_KEY_MGMT=y
```

## prj_qemu_x86.conf
```kconfig
#
# Copyright (c) 2020 Nordic Semiconductor ASA
#
# SPDX-License-Identifier: LicenseRef-Nordic-5-Clause
#

# General config
CONFIG_TEST_RANDOM_GENERATOR=y
CONFIG_NEWLIB_LIBC=y
CONFIG_LOG=y

# MQTT
CONFIG_MQTT_LIB=y
CONFIG_MQTT_LIB_TLS=n

# Networking config
CONFIG_NETWORKING=y
CONFIG_NET_IPV4=y
CONFIG_NET_TCP=y
CONFIG_NET_SOCKETS=y
CONFIG_NET_SOCKETS_POSIX_NAMES=y

CONFIG_DNS_RESOLVER=y
CONFIG_DNS_SERVER_IP_ADDRESSES=y
CONFIG_DNS_SERVER1="8.8.8.8"

# Network address config
CONFIG_NET_CONFIG_SETTINGS=y
CONFIG_NET_CONFIG_NEED_IPV4=y
CONFIG_NET_CONFIG_MY_IPV4_ADDR="192.0.2.1"
CONFIG_NET_CONFIG_PEER_IPV4_ADDR="192.0.2.2"
CONFIG_NET_CONFIG_MY_IPV4_GW="192.0.2.2"

# Application
#CONFIG_MQTT_PUB_TOPIC="/my/publish/topic"
#CONFIG_MQTT_SUB_TOPIC="/my/subscribe/topic"
#CONFIG_MQTT_CLIENT_ID="my-client-id"
#CONFIG_MQTT_BROKER_HOSTNAME="mqtt.eclipseprojects.io"
#CONFIG_MQTT_BROKER_PORT=1883

# Memory
CONFIG_HEAP_MEM_POOL_SIZE=16384
CONFIG_MAIN_STACK_SIZE=16384
```

## src/main.c
```c
/*
 * Copyright (c) 2018 Nordic Semiconductor ASA
 *
 * SPDX-License-Identifier: LicenseRef-Nordic-5-Clause
 */

#include <zephyr/kernel.h>
#include <stdio.h>
#include <string.h>
#include <zephyr/logging/log.h>
#include <dk_buttons_and_leds.h>
#include "emds/emds.h"

LOG_MODULE_REGISTER(mqtt_simple, CONFIG_MQTT_SIMPLE_LOG_LEVEL);

#define EMDS_DEV_IRQ 23
#define EMDS_DEV_PRIO 0
#define EMDS_ISR_ARG 0
#define EMDS_IRQ_FLAGS 0

// Some fake data for EMDS
static uint8_t _some_data[702];
#define SHARED_DATA_EMDS_ID ((int) 0x100)
EMDS_STATIC_ENTRY_DEFINE(shared_data_store, SHARED_DATA_EMDS_ID, &_some_data, sizeof(_some_data));



static void app_emds_cb(void)
{
    NVIC_SystemReset();
}

static void isr_emds_cb(void *arg)
{
	ARG_UNUSED(arg);
	emds_store();
}

uint32_t shared_data_init(void)
{
 

#ifdef CONFIG_EMDS
	int err = emds_init(&app_emds_cb);
	if (err) {
		printk("Initializing emds failed (err %d)\n", err);
		return;
	}

	err = emds_load();
	if (err) {
		printk("Restore of emds data failed (err %d)\n", err);
		return 1;
	}

	err = emds_prepare();
	if (err) {
		printk("Preparation emds failed (err %d)\n", err);
		return 1;
	}

    LOG_INF("Recovered = 0x%02x", _some_data[2]);

	_some_data[2] = 0xAA;

    
	IRQ_CONNECT(EMDS_DEV_IRQ, EMDS_DEV_PRIO, isr_emds_cb,
		    EMDS_ISR_ARG, EMDS_IRQ_FLAGS);
	irq_enable(EMDS_DEV_IRQ);
#endif

    return 0;
}


uint32_t shared_data_shutdown(void)
{
#ifdef CONFIG_EMDS
    emds_store();
#endif
    return 0;
}


#if defined(CONFIG_DK_LIBRARY)
static void button_handler(uint32_t button_states, uint32_t has_changed)
{
	if (has_changed & button_states &
	    BIT(CONFIG_BUTTON_EVENT_BTN_NUM - 1)) {
		int ret;
		printk("BUTTON PUSHED: start shared data shutdown");
		shared_data_shutdown();
	}
}
#endif


void main(void)
{

	LOG_INF("EMDS Example Started");
	shared_data_init();

#if defined(CONFIG_DK_LIBRARY)
	dk_buttons_init(button_handler);
#endif

	while(1)
	{
		k_sleep(K_MSEC(1000));
	}
}
```

## src/certificates.h
```c
/*
 * Copyright (c) 2020 Nordic Semiconductor ASA
 *
 * SPDX-License-Identifier: LicenseRef-Nordic-5-Clause
 */

/** CA certificate for mqtt.eclipseprojects.io, Let’s Encrypt R3 */
#define CA_CERTIFICATE \
	"-----BEGIN CERTIFICATE-----\n" \
	"MIIEZTCCA02gAwIBAgIQQAF1BIMUpMghjISpDBbN3zANBgkqhkiG9w0BAQsFADA/\n" \
	"MSQwIgYDVQQKExtEaWdpdGFsIFNpZ25hdHVyZSBUcnVzdCBDby4xFzAVBgNVBAMT\n" \
	"DkRTVCBSb290IENBIFgzMB4XDTIwMTAwNzE5MjE0MFoXDTIxMDkyOTE5MjE0MFow\n" \
	"MjELMAkGA1UEBhMCVVMxFjAUBgNVBAoTDUxldCdzIEVuY3J5cHQxCzAJBgNVBAMT\n" \
	"AlIzMIIBIjANBgkqhkiG9w0BAQEFAAOCAQ8AMIIBCgKCAQEAuwIVKMz2oJTTDxLs\n" \
	"jVWSw/iC8ZmmekKIp10mqrUrucVMsa+Oa/l1yKPXD0eUFFU1V4yeqKI5GfWCPEKp\n" \
	"Tm71O8Mu243AsFzzWTjn7c9p8FoLG77AlCQlh/o3cbMT5xys4Zvv2+Q7RVJFlqnB\n" \
	"U840yFLuta7tj95gcOKlVKu2bQ6XpUA0ayvTvGbrZjR8+muLj1cpmfgwF126cm/7\n" \
	"gcWt0oZYPRfH5wm78Sv3htzB2nFd1EbjzK0lwYi8YGd1ZrPxGPeiXOZT/zqItkel\n" \
	"/xMY6pgJdz+dU/nPAeX1pnAXFK9jpP+Zs5Od3FOnBv5IhR2haa4ldbsTzFID9e1R\n" \
	"oYvbFQIDAQABo4IBaDCCAWQwEgYDVR0TAQH/BAgwBgEB/wIBADAOBgNVHQ8BAf8E\n" \
	"BAMCAYYwSwYIKwYBBQUHAQEEPzA9MDsGCCsGAQUFBzAChi9odHRwOi8vYXBwcy5p\n" \
	"ZGVudHJ1c3QuY29tL3Jvb3RzL2RzdHJvb3RjYXgzLnA3YzAfBgNVHSMEGDAWgBTE\n" \
	"p7Gkeyxx+tvhS5B1/8QVYIWJEDBUBgNVHSAETTBLMAgGBmeBDAECATA/BgsrBgEE\n" \
	"AYLfEwEBATAwMC4GCCsGAQUFBwIBFiJodHRwOi8vY3BzLnJvb3QteDEubGV0c2Vu\n" \
	"Y3J5cHQub3JnMDwGA1UdHwQ1MDMwMaAvoC2GK2h0dHA6Ly9jcmwuaWRlbnRydXN0\n" \
	"LmNvbS9EU1RST09UQ0FYM0NSTC5jcmwwHQYDVR0OBBYEFBQusxe3WFbLrlAJQOYf\n" \
	"r52LFMLGMB0GA1UdJQQWMBQGCCsGAQUFBwMBBggrBgEFBQcDAjANBgkqhkiG9w0B\n" \
	"AQsFAAOCAQEA2UzgyfWEiDcx27sT4rP8i2tiEmxYt0l+PAK3qB8oYevO4C5z70kH\n" \
	"ejWEHx2taPDY/laBL21/WKZuNTYQHHPD5b1tXgHXbnL7KqC401dk5VvCadTQsvd8\n" \
	"S8MXjohyc9z9/G2948kLjmE6Flh9dDYrVYA9x2O+hEPGOaEOa1eePynBgPayvUfL\n" \
	"qjBstzLhWVQLGAkXXmNs+5ZnPBxzDJOLxhF2JIbeQAcH5H0tZrUlo5ZYyOqA7s9p\n" \
	"O5b85o3AM/OJ+CktFBQtfvBhcJVd9wvlwPsk+uyOy2HI7mNxKKgsBTt375teA2Tw\n" \
	"UdHkhVNcsAKX1H7GNNLOEADksd86wuoXvg==\n" \
	"-----END CERTIFICATE-----\n"
```

## src/new_main.c
```c
/*
 * Copyright (c) 2018 Nordic Semiconductor ASA
 *
 * SPDX-License-Identifier: LicenseRef-Nordic-5-Clause
 */

#include <zephyr/kernel.h>
#include <stdio.h>
#include <string.h>
#include <zephyr/logging/log.h>
#include <dk_buttons_and_leds.h>
#include <zephyr/sys/printk.h>
#include "emds/emds.h"

LOG_MODULE_REGISTER(mqtt_simple, CONFIG_MQTT_SIMPLE_LOG_LEVEL);

#define EMDS_DEV_IRQ 24
#define EMDS_DEV_PRIO 0
#define EMDS_ISR_ARG 0
#define EMDS_IRQ_FLAGS 0

// Some fake data for EMDS
static uint8_t _some_data[702];
#define SHARED_DATA_EMDS_ID ((int) 0x100)
EMDS_STATIC_ENTRY_DEFINE(shared_data_store, SHARED_DATA_EMDS_ID, &_some_data, sizeof(_some_data));

static void button_handler_cb(uint32_t button_states, uint32_t has_changed)
{
	printk("Got to button handler\n");

	if (has_changed & button_states & DK_BTN1_MSK) {
		printk("BUTTON 1 PUSHED\n");
		NVIC_SetPendingIRQ(EMDS_DEV_IRQ);
	}
	
}

static void app_emds_cb(void)
{
	printk("SAMPLE HALTED!!!\n");
	// dk_set_leds(DK_LED2_MSK | DK_LED3_MSK | DK_LED4_MSK);
	// k_fatal_halt(K_ERR_CPU_EXCEPTION);
	// NVIC_SystemReset();
}

static void isr_emds_cb(void *arg)
{
	int err;
	ARG_UNUSED(arg);

	// /* Stop mpsl to reduce power usage. */
	// irq_disable(TIMER0_IRQn);
	// irq_disable(RTC0_IRQn);
	// irq_disable(RADIO_IRQn);

	// mpsl_uninit();

	printk("Interrupt callback activated\n");
	
	err = emds_store();
	if(err){
		printk("emds_store FAILED!\n");
	}
}

void main(void)
{
	int err;
	printk("EMDS example Started\n");

	printk("Initializing buttons...\n");
	dk_buttons_init(NULL);

#ifdef CONFIG_EMDS
	static struct button_handler button_handler = {
		.cb = button_handler_cb,
	};

	dk_button_handler_add(&button_handler);

	err = emds_init(&app_emds_cb);
	if (err) {
		printk("Initializing emds failed (err %d)\n", err);
		return;
	}

	err = emds_load();
	if (err) {
		printk("Restore of emds data failed (err %d)\n", err);
		return;
	}

	err = emds_prepare();
	if (err) {
		printk("Preparation emds failed (err %d)\n", err);
		return;
	}

	IRQ_CONNECT(EMDS_DEV_IRQ, EMDS_DEV_PRIO, isr_emds_cb,
		    EMDS_ISR_ARG, EMDS_IRQ_FLAGS);
	irq_enable(EMDS_DEV_IRQ);


	if (IS_ENABLED(CONFIG_SETTINGS)) {
		settings_load();
	}
	#endif

}
```
